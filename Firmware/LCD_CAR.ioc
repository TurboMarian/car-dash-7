# file: LCD_CAR.ioc
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ADC1.Channel-0\#ChannelRegularConversion=ADC_CHANNEL_11
ADC1.NbrOfConversionFlag=1
ADC1.Rank-0\#ChannelRegularConversion=1
ADC1.SamplingTime-0\#ChannelRegularConversion=ADC_SAMPLETIME_3CYCLES
ADC1.master=1
CAN1.BS1=CAN_BS1_3TQ
CAN1.BS2=CAN_BS2_3TQ
CAN1.CalculateBaudRate=500000
CAN1.CalculateTimeBit=2000
CAN1.CalculateTimeQuantum=285.7142857142857
CAN1.Prescaler=12
CAN2.BS1=CAN_BS1_3TQ
CAN2.BS2=CAN_BS2_3TQ
CAN2.CalculateBaudRate=500000
CAN2.CalculateTimeBit=2000
CAN2.CalculateTimeQuantum=285.7142857142857
CAN2.Prescaler=12
DMA2D.ColorMode=DMA2D_OUTPUT_RGB565
DMA2D.InputColorModeBackground=DMA2D_INPUT_RGB565
DMA2D.InputColorModeForeground=DMA2D_INPUT_RGB565
DMA2D.Mode=DMA2D_M2M_BLEND
FMC.CASLatency1=FMC_SDRAM_CAS_LATENCY_3
FMC.ColumnBitsNumber1=FMC_SDRAM_COLUMN_BITS_NUM_9
FMC.ExitSelfRefreshDelay1=8
FMC.LoadToActiveDelay1=2
FMC.RCDDelay1=2
FMC.RPDelay1=2
FMC.ReadBurst1=FMC_SDRAM_RBURST_ENABLE
FMC.ReadPipeDelay1=FMC_SDRAM_RPIPE_DELAY_1
FMC.RowCycleDelay1=7
FMC.SDClockPeriod1=FMC_SDRAM_CLOCK_PERIOD_2
FMC.SelfRefreshTime1=6
FMC.WriteRecoveryTime1=5
FREERTOS.HEAP_NUMBER=3
FREERTOS.Tasks01=START_Task,8,128,Start_START_Task,Default,NULL,Dynamic,NULL,NULL;TouchGFXTask,24,4096,TouchGFX_Task,As weak,NULL,Dynamic,NULL,NULL;LOOKUP_Task,8,128,Start_LOOKUP_Task,Default,NULL,Dynamic,NULL,NULL;CONFIG_Task,8,128,Start_CONFIG_Task,Default,NULL,Dynamic,NULL,NULL;RGB_Task,8,1024,Start_RGB_Task,Default,NULL,Dynamic,NULL,NULL;SD_Task,8,128,Start_SD_Task,Default,NULL,Dynamic,NULL,NULL;HID_SEND_Task,8,64,Start_HID_SEND_Task,Default,NULL,Dynamic,NULL,NULL;HID_RECIEVE_Tas,8,64,Start_HID_RECIEVE_Task,Default,NULL,Dynamic,NULL,NULL
FREERTOS.configASSERT(\ x\ )=if ((x) \=\= 0) {taskDISABLE_INTERRUPTS(); for( ;; );} 
FREERTOS.configGENERATE_RUN_TIME_STATS=0
FREERTOS.configMINIMAL_STACK_SIZE=64
FREERTOS.configPRIO_BITS=4
FREERTOS.configRECORD_STACK_HIGH_ADDRESS=0
FREERTOS.configTIMER_QUEUE_LENGTH=10
FREERTOS.configTOTAL_HEAP_SIZE=48360
FREERTOS.configUSE_NEWLIB_REENTRANT=1
FREERTOS.configUSE_STATS_FORMATTING_FUNCTIONS=0
FREERTOS.copyHeapFile=0
I2C2.Analog_Filter=I2C_ANALOGFILTER_ENABLE
I2C2.ClockSpeed=400000
I2C2.I2C_Mode=I2C_Fast
LTDC.ActiveH=600
LTDC.ActiveW=1024
LTDC.Alpha_L0=255
LTDC.BlendingFactor1_L0=LTDC_BLENDING_FACTOR1_PAxCA
LTDC.BlendingFactor2_L0=LTDC_BLENDING_FACTOR2_PAxCA
LTDC.Blue_L0=0
LTDC.DEPolarity=LTDC_DEPOLARITY_AL
LTDC.FBStartAdress_L0=0xD0000000
LTDC.Green=0
LTDC.Green_L0=0
LTDC.HBP=140
LTDC.HFP=160
LTDC.HSPolarity=LTDC_HSPOLARITY_AL
LTDC.HSync=21
LTDC.ImageHeight_L0=600
LTDC.ImageWidth_L0=1024
LTDC.Layers=0
LTDC.PCPolarity=LTDC_PCPOLARITY_IPC
LTDC.PixelFormat_L0=LTDC_PIXEL_FORMAT_RGB565
LTDC.Red=0
LTDC.VBP=12
LTDC.VFP=20
LTDC.VSPolarity=LTDC_VSPOLARITY_AL
LTDC.VSync=4
LTDC.WindowX1_L0=1024
LTDC.WindowY1_L0=600
Mcu.Family=STM32F4
Mcu.Name=STM32F429B(E-G-I)Tx
Mcu.Package=LQFP208
NVIC.CAN1_RX0_IRQn=true\:5\:0\:false\:false\:true\:true\:true\:true\:true
NVIC.CAN2_RX0_IRQn=true\:5\:0\:false\:false\:true\:true\:true\:true\:true
NVIC.DMA2D_IRQn=true\:5\:0\:false\:false\:true\:true\:true\:true\:true
NVIC.EXTI15_10_IRQn=true\:5\:0\:false\:false\:true\:true\:true\:true\:true
NVIC.FMC_IRQn=true\:5\:0\:false\:false\:true\:true\:true\:true\:true
NVIC.LTDC_IRQn=true\:5\:0\:false\:false\:true\:true\:true\:true\:true
NVIC.OTG_FS_IRQn=true\:5\:0\:false\:false\:true\:true\:false\:true\:true
NVIC.PriorityGroup=NVIC_PRIORITYGROUP_4
NVIC.SPI1_IRQn=true\:5\:0\:false\:false\:true\:true\:true\:true\:true
NVIC.TIM6_DAC_IRQn=true\:15\:0\:false\:false\:true\:false\:false\:true\:true
NVIC.TimeBase=TIM6_DAC_IRQn
NVIC.TimeBaseIP=TIM6
PA0/WKUP.GPIO_Label=MULTISENSE_IN8
PA0/WKUP.Signal=S_TIM5_CH1
PA10.Mode=Asynchronous
PA10.Signal=USART1_RX
PA11.Mode=Device_Only
PA11.Signal=USB_OTG_FS_DM
PA12.Mode=Device_Only
PA12.Signal=USB_OTG_FS_DP
PA13.Mode=Serial_Wire
PA13.Signal=SYS_JTMS-SWDIO
PA14.Mode=Serial_Wire
PA14.Signal=SYS_JTCK-SWCLK
PA2.Signal=ADCx_IN2
PA5.GPIO_Label=MULTISENSE_IN9
PA5.Signal=S_TIM2_CH1_ETR
PA6.GPIO_Label=MULTISENSE_IN1
PA6.Signal=S_TIM3_CH1
PA7.GPIO_Label=MULTISENSE_IN0
PA7.Signal=S_TIM3_CH2
PA9.Mode=Asynchronous
PA9.Signal=USART1_TX
PB0.GPIO_Label=MULTISENSE_IN3
PB0.Signal=S_TIM3_CH3
PB1.GPIO_Mode=GPIO_MODE_AF_PP
PB1.GPIO_PuPd=GPIO_PULLUP
PB1.GPIO_Speed=GPIO_SPEED_FREQ_VERY_HIGH
PB1.Mode=RGB565
PB1.Signal=LTDC_R6
PB12.GPIO_PuPd=GPIO_PULLUP
PB12.Mode=CAN_Activate
PB12.Signal=CAN2_RX
PB13.Mode=CAN_Activate
PB13.Signal=CAN2_TX
PB14.GPIO_Label=MULTISENSE_IN14
PB14.Signal=S_TIM12_CH1
PB15.GPIO_Label=MULTISENSE_IN15
PB15.Signal=S_TIM12_CH2
PB3.Mode=Full_Duplex_Master
PB3.Signal=SPI1_SCK
PB4.Mode=Full_Duplex_Master
PB4.Signal=SPI1_MISO
PB5.Mode=Full_Duplex_Master
PB5.Signal=SPI1_MOSI
PB7.GPIO_Label=SPI1_FLASH
PB7.Signal=GPIO_Output
PB8.GPIO_PuPd=GPIO_PULLUP
PB8.Mode=CAN_Activate
PB8.Signal=CAN1_RX
PB9.Mode=CAN_Activate
PB9.Signal=CAN1_TX
PC0.Signal=FMC_SDNWE
PC1.GPIO_Label=MULTISENSE_ADC
PC1.Signal=ADCx_IN11
PC10.GPIO_PuPd=GPIO_PULLUP
PC10.GPIO_Speed=GPIO_SPEED_FREQ_VERY_HIGH
PC10.Mode=Full_Duplex_Master
PC10.Signal=SPI3_SCK
PC11.GPIO_PuPd=GPIO_PULLUP
PC11.GPIO_Speed=GPIO_SPEED_FREQ_VERY_HIGH
PC11.Mode=Full_Duplex_Master
PC11.Signal=SPI3_MISO
PC12.GPIO_PuPd=GPIO_PULLUP
PC12.GPIO_Speed=GPIO_SPEED_FREQ_VERY_HIGH
PC12.Mode=Full_Duplex_Master
PC12.Signal=SPI3_MOSI
PC14/OSC32_IN.Mode=LSE-External-Oscillator
PC14/OSC32_IN.Signal=RCC_OSC32_IN
PC15/OSC32_OUT.Mode=LSE-External-Oscillator
PC15/OSC32_OUT.Signal=RCC_OSC32_OUT
PC6.GPIO_Label=MULTISENSE_IN4
PC6.Signal=S_TIM8_CH1
PC7.GPIO_Label=MULTISENSE_IN5
PC7.Signal=S_TIM8_CH2
PD0.Signal=FMC_D2_DA2
PD1.Signal=FMC_D3_DA3
PD10.Signal=FMC_D15_DA15
PD12.GPIO_Label=MULTISENSE_IN7
PD12.Signal=S_TIM4_CH1
PD13.GPIO_Label=MULTISENSE_IN6
PD13.Signal=S_TIM4_CH2
PD14.Signal=FMC_D0_DA0
PD15.Signal=FMC_D1_DA1
PD2.GPIO_Label=SD_CS
PD2.GPIO_PuPd=GPIO_PULLUP
PD2.Signal=GPIO_Output
PD3.GPIO_Label=PUD_S0
PD3.Signal=GPIO_Output
PD4.GPIO_Label=PUD_S1
PD4.Signal=GPIO_Output
PD5.GPIO_Label=PUD_S2
PD5.Signal=GPIO_Output
PD7.GPIO_Label=PUD_E
PD7.Signal=GPIO_Output
PD8.Signal=FMC_D13_DA13
PD9.Signal=FMC_D14_DA14
PE0.Signal=FMC_NBL0
PE1.Signal=FMC_NBL1
PE10.Signal=FMC_D7_DA7
PE11.Signal=FMC_D8_DA8
PE12.Signal=FMC_D9_DA9
PE13.Signal=FMC_D10_DA10
PE14.Signal=FMC_D11_DA11
PE15.Signal=FMC_D12_DA12
PE2.GPIO_Label=BTN_1
PE2.Signal=GPIO_Input
PE3.GPIO_Label=BTN_2
PE3.Signal=GPIO_Input
PE5.GPIO_Label=MULTISENSE_IN10
PE5.Signal=S_TIM9_CH1
PE6.GPIO_Label=MULTISENSE_IN11
PE6.Signal=S_TIM9_CH2
PE7.Signal=FMC_D4_DA4
PE8.Signal=FMC_D5_DA5
PE9.Signal=FMC_D6_DA6
PF0.Signal=FMC_A0
PF1.Signal=FMC_A1
PF10.GPIO_Mode=GPIO_MODE_AF_PP
PF10.GPIO_PuPd=GPIO_PULLUP
PF10.GPIO_Speed=GPIO_SPEED_FREQ_VERY_HIGH
PF10.Mode=RGB565
PF10.Signal=LTDC_DE
PF11.Signal=FMC_SDNRAS
PF12.Signal=FMC_A6
PF13.Signal=FMC_A7
PF14.Signal=FMC_A8
PF15.Signal=FMC_A9
PF2.Signal=FMC_A2
PF3.Signal=FMC_A3
PF4.Signal=FMC_A4
PF5.Signal=FMC_A5
PF6.GPIO_Label=MULTISENSE_IN13
PF6.Signal=S_TIM10_CH1
PF7.GPIO_Label=MULTISENSE_IN12
PF7.Signal=S_TIM11_CH1
PF8.Signal=S_TIM13_CH1
PF9.GPIO_Label=MULTISENSE_IN2
PF9.Signal=S_TIM14_CH1
PG0.Signal=FMC_A10
PG1.Signal=FMC_A11
PG10.GPIO_Label=IN_S0
PG10.Signal=GPIO_Output
PG11.GPIO_Mode=GPIO_MODE_AF_PP
PG11.GPIO_PuPd=GPIO_PULLUP
PG11.GPIO_Speed=GPIO_SPEED_FREQ_VERY_HIGH
PG11.Mode=RGB565
PG11.Signal=LTDC_B3
PG12.GPIO_Label=IN_S1
PG12.Signal=GPIO_Output
PG13.GPIO_Label=IN_S2
PG13.Signal=GPIO_Output
PG14.GPIO_Label=IN_S3
PG14.Signal=GPIO_Output
PG15.Signal=FMC_SDNCAS
PG2.Signal=FMC_A12
PG3.GPIO_Label=SDIO_ENT
PG3.Signal=GPIO_Input
PG4.Signal=FMC_A14_BA0
PG5.Signal=FMC_A15_BA1
PG6.GPIO_Mode=GPIO_MODE_AF_PP
PG6.GPIO_PuPd=GPIO_PULLUP
PG6.GPIO_Speed=GPIO_SPEED_FREQ_VERY_HIGH
PG6.Mode=RGB565
PG6.Signal=LTDC_R7
PG7.GPIO_Mode=GPIO_MODE_AF_PP
PG7.GPIO_PuPd=GPIO_PULLUP
PG7.GPIO_Speed=GPIO_SPEED_FREQ_VERY_HIGH
PG7.Mode=RGB565
PG7.Signal=LTDC_CLK
PG8.Signal=FMC_SDCLK
PG9.GPIO_Label=IN_E
PG9.Signal=GPIO_Output
PH0/OSC_IN.Mode=HSE-External-Oscillator
PH0/OSC_IN.Signal=RCC_OSC_IN
PH1/OSC_OUT.Mode=HSE-External-Oscillator
PH1/OSC_OUT.Signal=RCC_OSC_OUT
PH10.GPIO_Mode=GPIO_MODE_AF_PP
PH10.GPIO_PuPd=GPIO_PULLUP
PH10.GPIO_Speed=GPIO_SPEED_FREQ_VERY_HIGH
PH10.Mode=RGB565
PH10.Signal=LTDC_R4
PH11.GPIO_Mode=GPIO_MODE_AF_PP
PH11.GPIO_PuPd=GPIO_PULLUP
PH11.GPIO_Speed=GPIO_SPEED_FREQ_VERY_HIGH
PH11.Mode=RGB565
PH11.Signal=LTDC_R5
PH13.GPIO_Mode=GPIO_MODE_AF_PP
PH13.GPIO_PuPd=GPIO_PULLUP
PH13.GPIO_Speed=GPIO_SPEED_FREQ_VERY_HIGH
PH13.Mode=RGB565
PH13.Signal=LTDC_G2
PH14.GPIO_Mode=GPIO_MODE_AF_PP
PH14.GPIO_PuPd=GPIO_PULLUP
PH14.GPIO_Speed=GPIO_SPEED_FREQ_VERY_HIGH
PH14.Mode=RGB565
PH14.Signal=LTDC_G3
PH15.GPIO_Mode=GPIO_MODE_AF_PP
PH15.GPIO_PuPd=GPIO_PULLUP
PH15.GPIO_Speed=GPIO_SPEED_FREQ_VERY_HIGH
PH15.Mode=RGB565
PH15.Signal=LTDC_G4
PH2.GPIO_Label=OUT_S0
PH2.Signal=GPIO_Output
PH3.GPIO_Label=OUT_E
PH3.Signal=GPIO_Output
PH4.GPIO_Pu=GPIO_PULLUP
PH4.Mode=I2C
PH4.Signal=I2C2_SCL
PH5.GPIO_Pu=GPIO_PULLUP
PH5.Mode=I2C
PH5.Signal=I2C2_SDA
PH6.Mode=SdramChipSelect2_1
PH6.Signal=FMC_SDNE1
PH7.Mode=SdramChipSelect2_1
PH7.Signal=FMC_SDCKE1
PH9.GPIO_Mode=GPIO_MODE_AF_PP
PH9.GPIO_PuPd=GPIO_PULLUP
PH9.GPIO_Speed=GPIO_SPEED_FREQ_VERY_HIGH
PH9.Mode=RGB565
PH9.Signal=LTDC_R3
PI0.GPIO_Mode=GPIO_MODE_AF_PP
PI0.GPIO_PuPd=GPIO_PULLUP
PI0.GPIO_Speed=GPIO_SPEED_FREQ_VERY_HIGH
PI0.Mode=RGB565
PI0.Signal=LTDC_G5
PI1.GPIO_Mode=GPIO_MODE_AF_PP
PI1.GPIO_PuPd=GPIO_PULLUP
PI1.GPIO_Speed=GPIO_SPEED_FREQ_VERY_HIGH
PI1.Mode=RGB565
PI1.Signal=LTDC_G6
PI10.GPIO_Mode=GPIO_MODE_AF_PP
PI10.GPIO_PuPd=GPIO_PULLUP
PI10.GPIO_Speed=GPIO_SPEED_FREQ_VERY_HIGH
PI10.Mode=RGB565
PI10.Signal=LTDC_HSYNC
PI11.GPIO_Label=TOUCH_EN
PI11.GPIO_PuPd=GPIO_PULLDOWN
PI11.Signal=GPXTI11
PI12.GPIO_Label=HALL_OUT_1_PI12
PI12.GPIO_PuPd=GPIO_NOPULL
PI12.Signal=GPIO_Input
PI2.GPIO_Mode=GPIO_MODE_AF_PP
PI2.GPIO_PuPd=GPIO_PULLUP
PI2.GPIO_Speed=GPIO_SPEED_FREQ_VERY_HIGH
PI2.Mode=RGB565
PI2.Signal=LTDC_G7
PI3.GPIO_Label=LED_PI3
PI3.Signal=GPIO_Output
PI4.GPIO_Mode=GPIO_MODE_AF_PP
PI4.GPIO_PuPd=GPIO_PULLUP
PI4.GPIO_Speed=GPIO_SPEED_FREQ_VERY_HIGH
PI4.Mode=RGB565
PI4.Signal=LTDC_B4
PI5.GPIO_Mode=GPIO_MODE_AF_PP
PI5.GPIO_PuPd=GPIO_PULLUP
PI5.GPIO_Speed=GPIO_SPEED_FREQ_VERY_HIGH
PI5.Mode=RGB565
PI5.Signal=LTDC_B5
PI6.GPIO_Mode=GPIO_MODE_AF_PP
PI6.GPIO_PuPd=GPIO_PULLUP
PI6.GPIO_Speed=GPIO_SPEED_FREQ_VERY_HIGH
PI6.Mode=RGB565
PI6.Signal=LTDC_B6
PI7.GPIO_Mode=GPIO_MODE_AF_PP
PI7.GPIO_PuPd=GPIO_PULLUP
PI7.GPIO_Speed=GPIO_SPEED_FREQ_VERY_HIGH
PI7.Mode=RGB565
PI7.Signal=LTDC_B7
PI9.GPIO_Mode=GPIO_MODE_AF_PP
PI9.GPIO_PuPd=GPIO_PULLUP
PI9.GPIO_Speed=GPIO_SPEED_FREQ_VERY_HIGH
PI9.Mode=RGB565
PI9.Signal=LTDC_VSYNC
PJ0.GPIO_Label=MULTISENSE_EN2
PJ0.Signal=GPIO_Output
PJ1.GPIO_Label=MULTISENSE_EN3
PJ1.Signal=GPIO_Output
PJ12.GPIO_Label=LED_PJ12
PJ12.Signal=GPIO_Output
PJ13.GPIO_Label=LED_PJ13
PJ13.Signal=GPIO_Output
PJ14.GPIO_Label=LED_PJ14
PJ14.Signal=GPIO_Output
PJ15.GPIO_Label=LED_PJ15
PJ15.Signal=GPIO_Output
PJ2.GPIO_Label=MULTISENSE_EN4
PJ2.Signal=GPIO_Output
PJ3.GPIO_Label=MULTISENSE_EN5
PJ3.Signal=GPIO_Output
PJ4.GPIO_Label=MULTISENSE_EN6
PJ4.Signal=GPIO_Output
PJ6.GPIO_Label=BTN_3
PJ6.Signal=GPIO_Input
PJ7.GPIO_Label=BTN_4
PJ7.Signal=GPIO_Input
PK0.GPIO_Label=MULTISENSE_EN0
PK0.Signal=GPIO_Output
PK1.GPIO_Label=MULTISENSE_EN1
PK1.Signal=GPIO_Output
PK2.GPIO_Label=MULTISENSE_RST
PK2.Signal=GPIO_Output
PK3.GPIO_Label=MULTISENSE_SEL0
PK3.Signal=GPIO_Output
PK4.GPIO_Label=MULTISENSE_SEL1
PK4.Signal=GPIO_Output
PK5.GPIO_Label=DET_+5V_S1
PK5.Signal=GPIO_Output
PK6.GPIO_Label=CAN1_SEL0
PK6.GPIO_ModeDefaultOutputPP=GPIO_MODE_OUTPUT_PP
PK6.GPIO_PuPd=GPIO_PULLDOWN
PK6.GPIO_Speed=GPIO_SPEED_FREQ_VERY_HIGH
PK6.PinState=GPIO_PIN_RESET
PK6.Signal=GPIO_Output
PK7.GPIO_Label=CAN2_SEL0
PK7.GPIO_ModeDefaultOutputPP=GPIO_MODE_OUTPUT_PP
PK7.GPIO_PuPd=GPIO_PULLDOWN
PK7.GPIO_Speed=GPIO_SPEED_FREQ_VERY_HIGH
PK7.PinState=GPIO_PIN_RESET
PK7.Signal=GPIO_Output
ProjectManager.HeapSize=0x1000
ProjectManager.StackSize=0x800
ProjectManager.TargetToolchain=STM32CubeIDE
RCC.48MHZClocksFreq_Value=48000000
RCC.AHBFreq_Value=168000000
RCC.APB1CLKDivider=RCC_HCLK_DIV4
RCC.APB1Freq_Value=42000000
RCC.APB1TimFreq_Value=84000000
RCC.APB2CLKDivider=RCC_HCLK_DIV2
RCC.APB2Freq_Value=84000000
RCC.APB2TimFreq_Value=168000000
RCC.CortexFreq_Value=168000000
RCC.EXTERNAL_CLOCK_VALUE=12288000
RCC.EnbaleCSS=true
RCC.FLatency-AdvancedSettings=FLASH_LATENCY_5
RCC.HCLKFreq_Value=168000000
RCC.HSEUsed=1
RCC.HSE_VALUE=12000000
RCC.HSI_VALUE=16000000
RCC.I2SClockSource=I2S_CLOCK_PLL
RCC.LSEUsed=0
RCC.LSIUsed=0
RCC.PLLM=6
RCC.PLLN=168
RCC.PLLQ=7
RCC.PLLSAIDivR=RCC_PLLSAIDIVR_4
RCC.PLLSAIN=80
RCC.PLLUsed=1
RCC.SAIClockSource_BlockA=SAI_CLKSOURCE_PLLSAI
RCC.SAIClockSource_BlockB=SAI_CLKSOURCE_PLLSAI
RCC.SYSCLKFreq_VALUE=168000000
RCC.SYSCLKSource=RCC_SYSCLKSOURCE_PLLCLK
RCC.VCOOutputFreq_Value=336000000
SH.ADCx_IN11.0=ADC1_IN11,IN11
SH.ADCx_IN2.0=ADC1_IN2,IN2
SH.FMC_A0.0=FMC_A0,13b-sda1
SH.FMC_A1.0=FMC_A1,13b-sda1
SH.FMC_A10.0=FMC_A10,13b-sda1
SH.FMC_A11.0=FMC_A11,13b-sda1
SH.FMC_A12.0=FMC_A12,13b-sda1
SH.FMC_A14_BA0.0=FMC_BA0,FourSdramBanks1
SH.FMC_A15_BA1.0=FMC_BA1,FourSdramBanks1
SH.FMC_A2.0=FMC_A2,13b-sda1
SH.FMC_A3.0=FMC_A3,13b-sda1
SH.FMC_A4.0=FMC_A4,13b-sda1
SH.FMC_A5.0=FMC_A5,13b-sda1
SH.FMC_A6.0=FMC_A6,13b-sda1
SH.FMC_A7.0=FMC_A7,13b-sda1
SH.FMC_A8.0=FMC_A8,13b-sda1
SH.FMC_A9.0=FMC_A9,13b-sda1
SH.FMC_D0_DA0.0=FMC_D0,sd-16b-d1
SH.FMC_D10_DA10.0=FMC_D10,sd-16b-d1
SH.FMC_D11_DA11.0=FMC_D11,sd-16b-d1
SH.FMC_D12_DA12.0=FMC_D12,sd-16b-d1
SH.FMC_D13_DA13.0=FMC_D13,sd-16b-d1
SH.FMC_D14_DA14.0=FMC_D14,sd-16b-d1
SH.FMC_D15_DA15.0=FMC_D15,sd-16b-d1
SH.FMC_D1_DA1.0=FMC_D1,sd-16b-d1
SH.FMC_D2_DA2.0=FMC_D2,sd-16b-d1
SH.FMC_D3_DA3.0=FMC_D3,sd-16b-d1
SH.FMC_D4_DA4.0=FMC_D4,sd-16b-d1
SH.FMC_D5_DA5.0=FMC_D5,sd-16b-d1
SH.FMC_D6_DA6.0=FMC_D6,sd-16b-d1
SH.FMC_D7_DA7.0=FMC_D7,sd-16b-d1
SH.FMC_D8_DA8.0=FMC_D8,sd-16b-d1
SH.FMC_D9_DA9.0=FMC_D9,sd-16b-d1
SH.FMC_NBL0.0=FMC_NBL0,Sd2ByteEnable1
SH.FMC_NBL1.0=FMC_NBL1,Sd2ByteEnable1
SH.FMC_SDCLK.0=FMC_SDCLK,13b-sda1
SH.FMC_SDNCAS.0=FMC_SDNCAS,13b-sda1
SH.FMC_SDNRAS.0=FMC_SDNRAS,13b-sda1
SH.FMC_SDNWE.0=FMC_SDNWE,13b-sda1
SH.S_TIM10_CH1.0=TIM10_CH1,PWM Generation1 CH1
SH.S_TIM11_CH1.0=TIM11_CH1,PWM Generation1 CH1
SH.S_TIM12_CH1.0=TIM12_CH1,PWM Generation1 CH1
SH.S_TIM12_CH2.0=TIM12_CH2,PWM Generation2 CH2
SH.S_TIM13_CH1.0=TIM13_CH1,PWM Generation1 CH1
SH.S_TIM14_CH1.0=TIM14_CH1,PWM Generation1 CH1
SH.S_TIM2_CH1_ETR.0=TIM2_CH1,PWM Generation1 CH1
SH.S_TIM3_CH1.0=TIM3_CH1,PWM Generation1 CH1
SH.S_TIM3_CH2.0=TIM3_CH2,PWM Generation2 CH2
SH.S_TIM3_CH3.0=TIM3_CH3,PWM Generation3 CH3
SH.S_TIM4_CH1.0=TIM4_CH1,PWM Generation1 CH1
SH.S_TIM4_CH2.0=TIM4_CH2,PWM Generation2 CH2
SH.S_TIM5_CH1.0=TIM5_CH1,PWM Generation1 CH1
SH.S_TIM8_CH1.0=TIM8_CH1,PWM Generation1 CH1
SH.S_TIM8_CH2.0=TIM8_CH2,PWM Generation2 CH2
SH.S_TIM9_CH1.0=TIM9_CH1,PWM Generation1 CH1
SH.S_TIM9_CH2.0=TIM9_CH2,PWM Generation2 CH2
SPI1.BaudRatePrescaler=SPI_BAUDRATEPRESCALER_4
SPI1.CalculateBaudRate=21.0 MBits/s
SPI1.Direction=SPI_DIRECTION_2LINES
SPI1.Mode=SPI_MODE_MASTER
SPI1.VirtualType=VM_MASTER
SPI3.BaudRatePrescaler=SPI_BAUDRATEPRESCALER_32
SPI3.CalculateBaudRate=1.3125 MBits/s
SPI3.Direction=SPI_DIRECTION_2LINES
SPI3.Mode=SPI_MODE_MASTER
SPI3.VirtualType=VM_MASTER
STMicroelectronics.X-CUBE-TOUCHGFX.4.23.0.ApplicationCcGraphicsJjApplication=TouchGFXOoGenerator
STMicroelectronics.X-CUBE-TOUCHGFX.4.23.0.tgfx_address1=0xD0000000
STMicroelectronics.X-CUBE-TOUCHGFX.4.23.0.tgfx_address2=0xD012C000
STMicroelectronics.X-CUBE-TOUCHGFX.4.23.0.tgfx_buffering_strategy=Double
STMicroelectronics.X-CUBE-TOUCHGFX.4.23.0.tgfx_display_interface=disp_ltdc
STMicroelectronics.X-CUBE-TOUCHGFX.4.23.0.tgfx_hardware_accelerator=dma_2d
STMicroelectronics.X-CUBE-TOUCHGFX.4.23.0.tgfx_location=By Address
STMicroelectronics.X-CUBE-TOUCHGFX.4.23.0.tgfx_vsync=vsync_ltdc
STMicroelectronics.X-CUBE-TOUCHGFX.4.23.0_IsPackSelfContextualization=true
TIM10.Channel=TIM_CHANNEL_1
TIM11.Channel=TIM_CHANNEL_1
TIM12.Channel-PWM\ Generation1\ CH1=TIM_CHANNEL_1
TIM12.Channel-PWM\ Generation2\ CH2=TIM_CHANNEL_2
TIM13.AutoReloadPreload=TIM_AUTORELOAD_PRELOAD_ENABLE
TIM13.Channel=TIM_CHANNEL_1
TIM13.Period=1000-1
TIM13.Prescaler=90-1
TIM14.Channel=TIM_CHANNEL_1
TIM2.Channel-PWM\ Generation1\ CH1=TIM_CHANNEL_1
TIM3.Channel-PWM\ Generation1\ CH1=TIM_CHANNEL_1
TIM3.Channel-PWM\ Generation2\ CH2=TIM_CHANNEL_2
TIM3.Channel-PWM\ Generation3\ CH3=TIM_CHANNEL_3
TIM4.Channel-PWM\ Generation1\ CH1=TIM_CHANNEL_1
TIM4.Channel-PWM\ Generation2\ CH2=TIM_CHANNEL_2
TIM5.Channel-PWM\ Generation1\ CH1=TIM_CHANNEL_1
TIM8.Channel-PWM\ Generation1\ CH1=TIM_CHANNEL_1
TIM8.Channel-PWM\ Generation2\ CH2=TIM_CHANNEL_2
TIM9.Channel-PWM\ Generation1\ CH1=TIM_CHANNEL_1
TIM9.Channel-PWM\ Generation2\ CH2=TIM_CHANNEL_2
USART1.VirtualMode=VM_ASYNC
USB_DEVICE.CLASS_NAME_FS=CUSTOM_HID
USB_DEVICE.VirtualMode-CUSTOM_HID_FS=CustomHid
USB_DEVICE.VirtualModeFS=Custom_Hid_FS
USB_OTG_FS.VirtualMode=Device_Only
VP_CRC_VS_CRC.Mode=CRC_Activate
VP_DMA2D_VS_DMA2D.Mode=DMA2D_Activate
VP_FATFS_VS_Generic.Mode=User_defined
VP_FREERTOS_VS_CMSIS_V2.Mode=CMSIS_V2
VP_STMicroelectronics.X-CUBE-TOUCHGFX_VS_GraphicsJjApplication_4.23.0.Mode=GraphicsJjApplication
VP_SYS_VS_tim6.Mode=TIM6
VP_TIM10_VS_ClockSourceINT.Mode=Enable_Timer
VP_TIM11_VS_ClockSourceINT.Mode=Enable_Timer
VP_TIM12_VS_ClockSourceINT.Mode=Internal
VP_TIM13_VS_ClockSourceINT.Mode=Enable_Timer
VP_TIM14_VS_ClockSourceINT.Mode=Enable_Timer
VP_TIM2_VS_ClockSourceINT.Mode=Internal
VP_TIM3_VS_ClockSourceINT.Mode=Internal
VP_TIM4_VS_ClockSourceINT.Mode=Internal
VP_TIM5_VS_ClockSourceINT.Mode=Internal
VP_TIM8_VS_ClockSourceINT.Mode=Internal
VP_TIM9_VS_ClockSourceINT.Mode=Internal
VP_USB_DEVICE_VS_USB_DEVICE_CUSTOM_HID_FS.Mode=CUSTOM_HID_FS
board=custom

// file: Core/Src/main.c
/* USER CODE BEGIN Header */
/**
 ******************************************************************************
 * @file           : main.c
 * @brief          : Main program body
 ******************************************************************************
 * @attention
 *
 * <h2><center>&copy; Copyright (c) 2021 STMicroelectronics.
 * All rights reserved.</center></h2>
 *
 * This software component is licensed by ST under BSD 3-Clause license,
 * the "License"; You may not use this file except in compliance with the
 * License. You may obtain a copy of the License at:
 *                        opensource.org/licenses/BSD-3-Clause
 *
 ******************************************************************************
 */
/* USER CODE END Header */
#include "main.h"
#include "cmsis_os.h"
#include "fatfs.h"
#include "app_touchgfx.h"
#include "usb_device.h"

/* USER CODE BEGIN Includes */
// #include <File_Handling.h>
#include "stm32f4xx_hal_flash_ex.h"
#include "stm32f4xx_hal_flash.h"
#include "Globals.hpp"
#include "sdram.h"
#include "WS2812/WS2812.hpp"
#include "SETUP/setup.hpp"
//#include "W25QXX/spi_flash.h"
//#include "MCUFlash/mcu_flash.h"

#include "FT5XX6/TargetTouch.h"

/* USER CODE END Includes */

/* USER CODE BEGIN PM */

uint8_t UART_RX_buffer[UART_RX_size];
uint8_t UART_RX_set;

uint8_t GPS_RX_buffer[GPS_RX_size];
uint8_t GPS_RX_Set;

/* USER CODE END PM */

ADC_HandleTypeDef hadc1;

CAN_HandleTypeDef hcan1;
CAN_HandleTypeDef hcan2;

CRC_HandleTypeDef hcrc;

DMA2D_HandleTypeDef hdma2d;

I2C_HandleTypeDef hi2c2;

LTDC_HandleTypeDef hltdc;

SPI_HandleTypeDef hspi1;
SPI_HandleTypeDef hspi3;

TIM_HandleTypeDef htim2;
TIM_HandleTypeDef htim3;
TIM_HandleTypeDef htim4;
TIM_HandleTypeDef htim5;
TIM_HandleTypeDef htim8;
TIM_HandleTypeDef htim9;
TIM_HandleTypeDef htim10;
TIM_HandleTypeDef htim11;
TIM_HandleTypeDef htim12;
TIM_HandleTypeDef htim13;
TIM_HandleTypeDef htim14;

UART_HandleTypeDef huart1;

SDRAM_HandleTypeDef hsdram1;

/* Definitions for START_Task */
osThreadId_t START_TaskHandle;
const osThreadAttr_t START_Task_attributes = { .name = "START_Task",
		.stack_size = 128 * 4, .priority = (osPriority_t) osPriorityLow, };
/* Definitions for TouchGFXTask */
osThreadId_t TouchGFXTaskHandle;
const osThreadAttr_t TouchGFXTask_attributes = { .name = "TouchGFXTask",
		.stack_size = 4096 * 4, .priority = (osPriority_t) osPriorityNormal, };
/* Definitions for LOOKUP_Task */
osThreadId_t LOOKUP_TaskHandle;
const osThreadAttr_t LOOKUP_Task_attributes = { .name = "LOOKUP_Task",
		.stack_size = 128 * 4, .priority = (osPriority_t) osPriorityLow, };
/* Definitions for CONFIG_Task */
osThreadId_t CONFIG_TaskHandle;
const osThreadAttr_t CONFIG_Task_attributes = { .name = "CONFIG_Task",
		.stack_size = 128 * 4, .priority = (osPriority_t) osPriorityLow, };
/* Definitions for RGB_Task */
osThreadId_t RGB_TaskHandle;
const osThreadAttr_t RGB_Task_attributes = { .name = "RGB_Task", .stack_size =
		1024 * 4, .priority = (osPriority_t) osPriorityLow, };
/* Definitions for SD_Task */
osThreadId_t SD_TaskHandle;
const osThreadAttr_t SD_Task_attributes = { .name = "SD_Task", .stack_size = 128
		* 4, .priority = (osPriority_t) osPriorityLow, };
/* Definitions for HID_SEND_Task */
osThreadId_t HID_SEND_TaskHandle;
const osThreadAttr_t HID_SEND_Task_attributes = { .name = "HID_SEND_Task",
		.stack_size = 64 * 4, .priority = (osPriority_t) osPriorityLow, };
/* Definitions for HID_RECIEVE_Tas */
osThreadId_t HID_RECIEVE_TasHandle;
const osThreadAttr_t HID_RECIEVE_Tas_attributes = { .name = "HID_RECIEVE_Tas",
		.stack_size = 64 * 4, .priority = (osPriority_t) osPriorityLow, };
/* USER CODE BEGIN PV */

extern USBD_HandleTypeDef hUsbDeviceFS;
uint8_t USB_TX_Buffer[OPF_HID_EPIN_SIZE];
uint8_t USB_RX_Buffer[OPF_HID_EPOUT_SIZE];
uint8_t USB_RX_Ready;

FMC_SDRAM_CommandTypeDef command;

uint8_t initFinished = false;

Statuses Current_Status;
Settings Dash_Settings;

CAN_TxHeaderTypeDef TxHeader;
CAN_RxHeaderTypeDef RxHeader;
uint8_t TxData[8];
uint8_t RxData[8];
uint32_t TxMailbox;

FILE *File;

FILE *FileBuffer;
uint8_t BufferIsSet;

uint32_t BlockAddress = 0x000000;
uint32_t Offset = 0x000000;

/* USER CODE END PV */

void SystemClock_Config(void);
static void MX_GPIO_Init(void);
static void MX_LTDC_Init(void);
static void MX_DMA2D_Init(void);
static void MX_FMC_Init(void);
static void MX_CRC_Init(void);
static void MX_TIM13_Init(void);
static void MX_CAN1_Init(void);
static void MX_CAN2_Init(void);
static void MX_I2C2_Init(void);
static void MX_ADC1_Init(void);
static void MX_SPI1_Init(void);
static void MX_USART1_UART_Init(void);
static void MX_TIM2_Init(void);
static void MX_TIM3_Init(void);
static void MX_TIM4_Init(void);
static void MX_TIM5_Init(void);
static void MX_TIM8_Init(void);
static void MX_TIM9_Init(void);
static void MX_TIM10_Init(void);
static void MX_TIM11_Init(void);
static void MX_TIM12_Init(void);
static void MX_TIM14_Init(void);
static void MX_SPI3_Init(void);
void Start_START_Task(void *argument);
void TouchGFX_Task(void *argument);
void Start_LOOKUP_Task(void *argument);
void Start_CONFIG_Task(void *argument);
void Start_RGB_Task(void *argument);
void Start_SD_Task(void *argument);
void Start_HID_SEND_Task(void *argument);
void Start_HID_RECIEVE_Task(void *argument);

/* USER CODE BEGIN PFP */

uint8_t switchToBootloader __attribute__ ((section (".noinit")));
void (*SysMemBootJump)(void);

/* USER CODE END PFP */

int main(void) {
	/* USER CODE BEGIN 1 */
	BufferIsSet = 0;

	if (switchToBootloader == 0x11) {
		//HAL_Delay(1000);
		JumpToDFU();
	}

	/* USER CODE END 1 */

	/* MCU Configuration--------------------------------------------------------*/

	/* Reset of all peripherals, Initializes the Flash interface and the Systick. */
	HAL_Init();

	/* Configure the system clock */
	SystemClock_Config();

	/* Initialize all configured peripherals */
	MX_GPIO_Init();
	MX_LTDC_Init();
	MX_DMA2D_Init();
	MX_FMC_Init();
	MX_CRC_Init();
	MX_TIM13_Init();
	MX_CAN1_Init();
	MX_CAN2_Init();
	MX_I2C2_Init();
	MX_ADC1_Init();
	MX_SPI1_Init();
	MX_USART1_UART_Init();
	MX_TIM2_Init();
	MX_TIM3_Init();
	MX_TIM4_Init();
	MX_TIM5_Init();
	MX_TIM8_Init();
	MX_TIM9_Init();
	MX_TIM10_Init();
	MX_TIM11_Init();
	MX_TIM12_Init();
	MX_TIM14_Init();
	MX_SPI3_Init();
	MX_FATFS_Init();
	MX_TouchGFX_Init();
	/* Call PreOsInit function */
	MX_TouchGFX_PreOSInit();

	/* Init scheduler */
	osKernelInitialize();

	/* Create the thread(s) */
	/* creation of START_Task */
	START_TaskHandle = osThreadNew(Start_START_Task, NULL,
			&START_Task_attributes);

	/* creation of TouchGFXTask */
	TouchGFXTaskHandle = osThreadNew(TouchGFX_Task, NULL,
			&TouchGFXTask_attributes);

	/* creation of LOOKUP_Task */
	LOOKUP_TaskHandle = osThreadNew(Start_LOOKUP_Task, NULL,
			&LOOKUP_Task_attributes);

	/* creation of CONFIG_Task */
	CONFIG_TaskHandle = osThreadNew(Start_CONFIG_Task, NULL,
			&CONFIG_Task_attributes);

	/* creation of RGB_Task */
	RGB_TaskHandle = osThreadNew(Start_RGB_Task, NULL, &RGB_Task_attributes);

	/* creation of SD_Task */
	SD_TaskHandle = osThreadNew(Start_SD_Task, NULL, &SD_Task_attributes);

	/* creation of HID_SEND_Task */
	HID_SEND_TaskHandle = osThreadNew(Start_HID_SEND_Task, NULL,
			&HID_SEND_Task_attributes);

	/* creation of HID_RECIEVE_Tas */
	HID_RECIEVE_TasHandle = osThreadNew(Start_HID_RECIEVE_Task, NULL,
			&HID_RECIEVE_Tas_attributes);

	/* Start scheduler */
	osKernelStart();

	/* We should never get here as control is now taken by the scheduler */
	/* Infinite loop */
	while (1) {

	}
}

void SystemClock_Config(void) {
	RCC_OscInitTypeDef RCC_OscInitStruct = { 0 };
	RCC_ClkInitTypeDef RCC_ClkInitStruct = { 0 };

	/** Configure the main internal regulator output voltage
	 */
	__HAL_RCC_PWR_CLK_ENABLE();
	__HAL_PWR_VOLTAGESCALING_CONFIG(PWR_REGULATOR_VOLTAGE_SCALE1);

	/** Initializes the RCC Oscillators according to the specified parameters
	 * in the RCC_OscInitTypeDef structure.
	 */
	RCC_OscInitStruct.OscillatorType = RCC_OSCILLATORTYPE_HSE;
	RCC_OscInitStruct.HSEState = RCC_HSE_ON;
	RCC_OscInitStruct.PLL.PLLState = RCC_PLL_ON;
	RCC_OscInitStruct.PLL.PLLSource = RCC_PLLSOURCE_HSE;
	RCC_OscInitStruct.PLL.PLLM = 6;
	RCC_OscInitStruct.PLL.PLLN = 168;
	RCC_OscInitStruct.PLL.PLLP = RCC_PLLP_DIV2;
	RCC_OscInitStruct.PLL.PLLQ = 7;
	if (HAL_RCC_OscConfig(&RCC_OscInitStruct) != HAL_OK) {
		Error_Handler();
	}

	/** Initializes the CPU, AHB and APB buses clocks
	 */
	RCC_ClkInitStruct.ClockType = RCC_CLOCKTYPE_HCLK | RCC_CLOCKTYPE_SYSCLK
			| RCC_CLOCKTYPE_PCLK1 | RCC_CLOCKTYPE_PCLK2;
	RCC_ClkInitStruct.SYSCLKSource = RCC_SYSCLKSOURCE_PLLCLK;
	RCC_ClkInitStruct.AHBCLKDivider = RCC_SYSCLK_DIV1;
	RCC_ClkInitStruct.APB1CLKDivider = RCC_HCLK_DIV4;
	RCC_ClkInitStruct.APB2CLKDivider = RCC_HCLK_DIV2;

	if (HAL_RCC_ClockConfig(&RCC_ClkInitStruct, FLASH_LATENCY_5) != HAL_OK) {
		Error_Handler();
	}

	/** Enables the Clock Security System
	 */
	HAL_RCC_EnableCSS();
}

static void MX_ADC1_Init(void) {

	ADC_ChannelConfTypeDef sConfig = { 0 };

	/** Configure the global features of the ADC (Clock, Resolution, Data Alignment and number of conversion)
	 */
	hadc1.Instance = ADC1;
	hadc1.Init.ClockPrescaler = ADC_CLOCK_SYNC_PCLK_DIV4;
	hadc1.Init.Resolution = ADC_RESOLUTION_12B;
	hadc1.Init.ScanConvMode = DISABLE;
	hadc1.Init.ContinuousConvMode = DISABLE;
	hadc1.Init.DiscontinuousConvMode = DISABLE;
	hadc1.Init.ExternalTrigConvEdge = ADC_EXTERNALTRIGCONVEDGE_NONE;
	hadc1.Init.ExternalTrigConv = ADC_SOFTWARE_START;
	hadc1.Init.DataAlign = ADC_DATAALIGN_RIGHT;
	hadc1.Init.NbrOfConversion = 1;
	hadc1.Init.DMAContinuousRequests = DISABLE;
	hadc1.Init.EOCSelection = ADC_EOC_SINGLE_CONV;
	if (HAL_ADC_Init(&hadc1) != HAL_OK) {
		Error_Handler();
	}

	/** Configure for the selected ADC regular channel its corresponding rank in the sequencer and its sample time.
	 */
	sConfig.Channel = ADC_CHANNEL_11;
	sConfig.Rank = 1;
	sConfig.SamplingTime = ADC_SAMPLETIME_3CYCLES;
	if (HAL_ADC_ConfigChannel(&hadc1, &sConfig) != HAL_OK) {
		Error_Handler();
	}

}

static void MX_CAN1_Init(void) {

	/* USER CODE BEGIN CAN1_Init 0 */

	CAN_FilterTypeDef sFilterConfig; // declare CAN filter structure
	/* USER CODE END CAN1_Init 0 */

	hcan1.Instance = CAN1;
	hcan1.Init.Prescaler = 12;
	hcan1.Init.Mode = CAN_MODE_NORMAL;
	hcan1.Init.SyncJumpWidth = CAN_SJW_1TQ;
	hcan1.Init.TimeSeg1 = CAN_BS1_3TQ;
	hcan1.Init.TimeSeg2 = CAN_BS2_3TQ;
	hcan1.Init.TimeTriggeredMode = DISABLE;
	hcan1.Init.AutoBusOff = DISABLE;
	hcan1.Init.AutoWakeUp = DISABLE;
	hcan1.Init.AutoRetransmission = DISABLE;
	hcan1.Init.ReceiveFifoLocked = DISABLE;
	hcan1.Init.TransmitFifoPriority = DISABLE;
	if (HAL_CAN_Init(&hcan1) != HAL_OK) {
		Error_Handler();
	}
	/* USER CODE BEGIN CAN1_Init 2 */
	sFilterConfig.FilterBank = 15;
	sFilterConfig.FilterMode = CAN_FILTERMODE_IDMASK;
	sFilterConfig.FilterScale = CAN_FILTERSCALE_32BIT;
	sFilterConfig.FilterIdHigh = 0x0000;
	sFilterConfig.FilterIdLow = 0x0000;
	sFilterConfig.FilterMaskIdHigh = 0x0000;
	sFilterConfig.FilterMaskIdLow = 0x0000;
	sFilterConfig.FilterFIFOAssignment = CAN_RX_FIFO0;
	sFilterConfig.FilterActivation = ENABLE;
	// sFilterConfig.SlaveStartFilterBank = 14;
	if (HAL_CAN_ConfigFilter(&hcan1, &sFilterConfig) != HAL_OK) {
		/* Filter configuration Error */
		Error_Handler();
	}
	if (HAL_CAN_Start(&hcan1) != HAL_OK) {
		/* Start Error */
		Error_Handler();
	}
	if (HAL_CAN_ActivateNotification(&hcan1, CAN_IT_RX_FIFO0_MSG_PENDING)
			!= HAL_OK) {
		Error_Handler();
	}
	__HAL_RCC_CAN1_CLK_ENABLE();
	//__HAL_RCC_CAN2_CLK_ENABLE();
	/* USER CODE END CAN1_Init 2 */

}

static void MX_CAN2_Init(void) {

	hcan2.Instance = CAN2;
	hcan2.Init.Prescaler = 12;
	hcan2.Init.Mode = CAN_MODE_NORMAL;
	hcan2.Init.SyncJumpWidth = CAN_SJW_1TQ;
	hcan2.Init.TimeSeg1 = CAN_BS1_3TQ;
	hcan2.Init.TimeSeg2 = CAN_BS2_3TQ;
	hcan2.Init.TimeTriggeredMode = DISABLE;
	hcan2.Init.AutoBusOff = DISABLE;
	hcan2.Init.AutoWakeUp = DISABLE;
	hcan2.Init.AutoRetransmission = DISABLE;
	hcan2.Init.ReceiveFifoLocked = DISABLE;
	hcan2.Init.TransmitFifoPriority = DISABLE;
	if (HAL_CAN_Init(&hcan2) != HAL_OK) {
		Error_Handler();
	}
	/* USER CODE BEGIN CAN2_Init 2 */

	if (HAL_CAN_Start(&hcan2) != HAL_OK) {
		/* Start Error */
		Error_Handler();
	}
	if (HAL_CAN_ActivateNotification(&hcan2, CAN_IT_RX_FIFO0_MSG_PENDING)
			!= HAL_OK) {
		Error_Handler();
	}
	__HAL_RCC_CAN2_CLK_ENABLE();
	/* USER CODE END CAN2_Init 2 */

}

static void MX_CRC_Init(void) {

	hcrc.Instance = CRC;
	if (HAL_CRC_Init(&hcrc) != HAL_OK) {
		Error_Handler();
	}

}

static void MX_DMA2D_Init(void) {

	hdma2d.Instance = DMA2D;
	hdma2d.Init.Mode = DMA2D_M2M_BLEND;
	hdma2d.Init.ColorMode = DMA2D_OUTPUT_RGB565;
	hdma2d.Init.OutputOffset = 0;
	hdma2d.LayerCfg[0].InputOffset = 0;
	hdma2d.LayerCfg[0].InputColorMode = DMA2D_INPUT_RGB565;
	hdma2d.LayerCfg[0].AlphaMode = DMA2D_NO_MODIF_ALPHA;
	hdma2d.LayerCfg[0].InputAlpha = 0;
	hdma2d.LayerCfg[1].InputOffset = 0;
	hdma2d.LayerCfg[1].InputColorMode = DMA2D_INPUT_RGB565;
	hdma2d.LayerCfg[1].AlphaMode = DMA2D_NO_MODIF_ALPHA;
	hdma2d.LayerCfg[1].InputAlpha = 0;
	if (HAL_DMA2D_Init(&hdma2d) != HAL_OK) {
		Error_Handler();
	}
	if (HAL_DMA2D_ConfigLayer(&hdma2d, 0) != HAL_OK) {
		Error_Handler();
	}
	if (HAL_DMA2D_ConfigLayer(&hdma2d, 1) != HAL_OK) {
		Error_Handler();
	}

}

static void MX_I2C2_Init(void) {

	hi2c2.Instance = I2C2;
	hi2c2.Init.ClockSpeed = 400000;
	hi2c2.Init.DutyCycle = I2C_DUTYCYCLE_2;
	hi2c2.Init.OwnAddress1 = 0;
	hi2c2.Init.AddressingMode = I2C_ADDRESSINGMODE_7BIT;
	hi2c2.Init.DualAddressMode = I2C_DUALADDRESS_DISABLE;
	hi2c2.Init.OwnAddress2 = 0;
	hi2c2.Init.GeneralCallMode = I2C_GENERALCALL_DISABLE;
	hi2c2.Init.NoStretchMode = I2C_NOSTRETCH_DISABLE;
	if (HAL_I2C_Init(&hi2c2) != HAL_OK) {
		Error_Handler();
	}

	/** Configure Analogue filter
	 */
	if (HAL_I2CEx_ConfigAnalogFilter(&hi2c2, I2C_ANALOGFILTER_ENABLE)
			!= HAL_OK) {
		Error_Handler();
	}

	/** Configure Digital filter
	 */
	if (HAL_I2CEx_ConfigDigitalFilter(&hi2c2, 0) != HAL_OK) {
		Error_Handler();
	}

}

static void MX_LTDC_Init(void) {

	LTDC_LayerCfgTypeDef pLayerCfg = { 0 };

	hltdc.Instance = LTDC;
	hltdc.Init.HSPolarity = LTDC_HSPOLARITY_AL;
	hltdc.Init.VSPolarity = LTDC_VSPOLARITY_AL;
	hltdc.Init.DEPolarity = LTDC_DEPOLARITY_AL;
	hltdc.Init.PCPolarity = LTDC_PCPOLARITY_IPC;
	hltdc.Init.HorizontalSync = 20;
	hltdc.Init.VerticalSync = 3;
	hltdc.Init.AccumulatedHBP = 160;
	hltdc.Init.AccumulatedVBP = 15;
	hltdc.Init.AccumulatedActiveW = 1184;
	hltdc.Init.AccumulatedActiveH = 615;
	hltdc.Init.TotalWidth = 1344;
	hltdc.Init.TotalHeigh = 635;
	hltdc.Init.Backcolor.Blue = 0;
	hltdc.Init.Backcolor.Green = 0;
	hltdc.Init.Backcolor.Red = 0;
	if (HAL_LTDC_Init(&hltdc) != HAL_OK) {
		Error_Handler();
	}
	pLayerCfg.WindowX0 = 0;
	pLayerCfg.WindowX1 = 1024;
	pLayerCfg.WindowY0 = 0;
	pLayerCfg.WindowY1 = 600;
	pLayerCfg.PixelFormat = LTDC_PIXEL_FORMAT_RGB565;
	pLayerCfg.Alpha = 255;
	pLayerCfg.Alpha0 = 0;
	pLayerCfg.BlendingFactor1 = LTDC_BLENDING_FACTOR1_PAxCA;
	pLayerCfg.BlendingFactor2 = LTDC_BLENDING_FACTOR2_PAxCA;
	pLayerCfg.FBStartAdress = 0xD0000000;
	pLayerCfg.ImageWidth = 1024;
	pLayerCfg.ImageHeight = 600;
	pLayerCfg.Backcolor.Blue = 0;
	pLayerCfg.Backcolor.Green = 0;
	pLayerCfg.Backcolor.Red = 0;
	if (HAL_LTDC_ConfigLayer(&hltdc, &pLayerCfg, 0) != HAL_OK) {
		Error_Handler();
	}
	/* USER CODE BEGIN LTDC_Init 2 */

	if (HAL_LTDC_DeInit(&hltdc) != HAL_OK) {
		Error_Handler();
	}
	hltdc.Init.HorizontalSync = LCD_RES_HS - 1;
	hltdc.Init.VerticalSync = LCD_RES_VS - 1;
	hltdc.Init.AccumulatedHBP = hltdc.Init.HorizontalSync + LCD_RES_HBP; // Horizontal Synchronization Width + Horizontal Back Porch - 1
	hltdc.Init.AccumulatedVBP = hltdc.Init.VerticalSync + LCD_RES_VBP; // Vertical Synchronization Height + Vertical Back Porch - 1
	hltdc.Init.AccumulatedActiveW = hltdc.Init.AccumulatedHBP + LCD_RES_H; // Horizontal Synchronization Width + Horizontal Back Porch + Active Width - 1
	hltdc.Init.AccumulatedActiveH = hltdc.Init.AccumulatedVBP + LCD_RES_V; // Vertical Synchronization Height + Vertical Back Porch + Active Height - 1
	hltdc.Init.TotalWidth = hltdc.Init.AccumulatedActiveW + LCD_RES_HFP; //Horizontal Synchronization Width + Horizontal Back Porch + Active Width + Horizontal Front Porch - 1
	hltdc.Init.TotalHeigh = hltdc.Init.AccumulatedActiveH + LCD_RES_VFP; //Vertical Synchronization Height + Vertical Back Porch + Active Height + Vertical Front Porch - 1
	if (HAL_LTDC_Init(&hltdc) != HAL_OK) {
		Error_Handler();
	}
	pLayerCfg.WindowX1 = LCD_RES_H;
	pLayerCfg.WindowY1 = LCD_RES_V;
	pLayerCfg.ImageWidth = LCD_RES_H;
	pLayerCfg.ImageHeight = LCD_RES_V;
	if (HAL_LTDC_ConfigLayer(&hltdc, &pLayerCfg, 0) != HAL_OK) {
		Error_Handler();
	}
	/* USER CODE END LTDC_Init 2 */

}

static void MX_SPI1_Init(void) {

	/* SPI1 parameter configuration*/
	hspi1.Instance = SPI1;
	hspi1.Init.Mode = SPI_MODE_MASTER;
	hspi1.Init.Direction = SPI_DIRECTION_2LINES;
	hspi1.Init.DataSize = SPI_DATASIZE_8BIT;
	hspi1.Init.CLKPolarity = SPI_POLARITY_LOW;
	hspi1.Init.CLKPhase = SPI_PHASE_1EDGE;
	hspi1.Init.NSS = SPI_NSS_SOFT;
	hspi1.Init.BaudRatePrescaler = SPI_BAUDRATEPRESCALER_4;
	hspi1.Init.FirstBit = SPI_FIRSTBIT_MSB;
	hspi1.Init.TIMode = SPI_TIMODE_DISABLE;
	hspi1.Init.CRCCalculation = SPI_CRCCALCULATION_DISABLE;
	hspi1.Init.CRCPolynomial = 10;
	if (HAL_SPI_Init(&hspi1) != HAL_OK) {
		Error_Handler();
	}

}

static void MX_SPI3_Init(void) {

	/* SPI3 parameter configuration*/
	hspi3.Instance = SPI3;
	hspi3.Init.Mode = SPI_MODE_MASTER;
	hspi3.Init.Direction = SPI_DIRECTION_2LINES;
	hspi3.Init.DataSize = SPI_DATASIZE_8BIT;
	hspi3.Init.CLKPolarity = SPI_POLARITY_LOW;
	hspi3.Init.CLKPhase = SPI_PHASE_1EDGE;
	hspi3.Init.NSS = SPI_NSS_SOFT;
	hspi3.Init.BaudRatePrescaler = SPI_BAUDRATEPRESCALER_32;
	hspi3.Init.FirstBit = SPI_FIRSTBIT_MSB;
	hspi3.Init.TIMode = SPI_TIMODE_DISABLE;
	hspi3.Init.CRCCalculation = SPI_CRCCALCULATION_DISABLE;
	hspi3.Init.CRCPolynomial = 10;
	if (HAL_SPI_Init(&hspi3) != HAL_OK) {
		Error_Handler();
	}

}

static void MX_TIM2_Init(void) {

	TIM_ClockConfigTypeDef sClockSourceConfig = { 0 };
	TIM_MasterConfigTypeDef sMasterConfig = { 0 };
	TIM_OC_InitTypeDef sConfigOC = { 0 };

	htim2.Instance = TIM2;
	htim2.Init.Prescaler = 0;
	htim2.Init.CounterMode = TIM_COUNTERMODE_UP;
	htim2.Init.Period = 4294967295;
	htim2.Init.ClockDivision = TIM_CLOCKDIVISION_DIV1;
	htim2.Init.AutoReloadPreload = TIM_AUTORELOAD_PRELOAD_DISABLE;
	if (HAL_TIM_Base_Init(&htim2) != HAL_OK) {
		Error_Handler();
	}
	sClockSourceConfig.ClockSource = TIM_CLOCKSOURCE_INTERNAL;
	if (HAL_TIM_ConfigClockSource(&htim2, &sClockSourceConfig) != HAL_OK) {
		Error_Handler();
	}
	if (HAL_TIM_PWM_Init(&htim2) != HAL_OK) {
		Error_Handler();
	}
	sMasterConfig.MasterOutputTrigger = TIM_TRGO_RESET;
	sMasterConfig.MasterSlaveMode = TIM_MASTERSLAVEMODE_DISABLE;
	if (HAL_TIMEx_MasterConfigSynchronization(&htim2, &sMasterConfig)
			!= HAL_OK) {
		Error_Handler();
	}
	sConfigOC.OCMode = TIM_OCMODE_PWM1;
	sConfigOC.Pulse = 0;
	sConfigOC.OCPolarity = TIM_OCPOLARITY_HIGH;
	sConfigOC.OCFastMode = TIM_OCFAST_DISABLE;
	if (HAL_TIM_PWM_ConfigChannel(&htim2, &sConfigOC, TIM_CHANNEL_1)
			!= HAL_OK) {
		Error_Handler();
	}
	HAL_TIM_MspPostInit(&htim2);

}

static void MX_TIM3_Init(void) {

	TIM_ClockConfigTypeDef sClockSourceConfig = { 0 };
	TIM_MasterConfigTypeDef sMasterConfig = { 0 };
	TIM_OC_InitTypeDef sConfigOC = { 0 };

	htim3.Instance = TIM3;
	htim3.Init.Prescaler = 0;
	htim3.Init.CounterMode = TIM_COUNTERMODE_UP;
	htim3.Init.Period = 65535;
	htim3.Init.ClockDivision = TIM_CLOCKDIVISION_DIV1;
	htim3.Init.AutoReloadPreload = TIM_AUTORELOAD_PRELOAD_DISABLE;
	if (HAL_TIM_Base_Init(&htim3) != HAL_OK) {
		Error_Handler();
	}
	sClockSourceConfig.ClockSource = TIM_CLOCKSOURCE_INTERNAL;
	if (HAL_TIM_ConfigClockSource(&htim3, &sClockSourceConfig) != HAL_OK) {
		Error_Handler();
	}
	if (HAL_TIM_PWM_Init(&htim3) != HAL_OK) {
		Error_Handler();
	}
	sMasterConfig.MasterOutputTrigger = TIM_TRGO_RESET;
	sMasterConfig.MasterSlaveMode = TIM_MASTERSLAVEMODE_DISABLE;
	if (HAL_TIMEx_MasterConfigSynchronization(&htim3, &sMasterConfig)
			!= HAL_OK) {
		Error_Handler();
	}
	sConfigOC.OCMode = TIM_OCMODE_PWM1;
	sConfigOC.Pulse = 0;
	sConfigOC.OCPolarity = TIM_OCPOLARITY_HIGH;
	sConfigOC.OCFastMode = TIM_OCFAST_DISABLE;
	if (HAL_TIM_PWM_ConfigChannel(&htim3, &sConfigOC, TIM_CHANNEL_1)
			!= HAL_OK) {
		Error_Handler();
	}
	if (HAL_TIM_PWM_ConfigChannel(&htim3, &sConfigOC, TIM_CHANNEL_2)
			!= HAL_OK) {
		Error_Handler();
	}
	if (HAL_TIM_PWM_ConfigChannel(&htim3, &sConfigOC, TIM_CHANNEL_3)
			!= HAL_OK) {
		Error_Handler();
	}
	HAL_TIM_MspPostInit(&htim3);

}

static void MX_TIM4_Init(void) {

	TIM_ClockConfigTypeDef sClockSourceConfig = { 0 };
	TIM_MasterConfigTypeDef sMasterConfig = { 0 };
	TIM_OC_InitTypeDef sConfigOC = { 0 };

	htim4.Instance = TIM4;
	htim4.Init.Prescaler = 0;
	htim4.Init.CounterMode = TIM_COUNTERMODE_UP;
	htim4.Init.Period = 65535;
	htim4.Init.ClockDivision = TIM_CLOCKDIVISION_DIV1;
	htim4.Init.AutoReloadPreload = TIM_AUTORELOAD_PRELOAD_DISABLE;
	if (HAL_TIM_Base_Init(&htim4) != HAL_OK) {
		Error_Handler();
	}
	sClockSourceConfig.ClockSource = TIM_CLOCKSOURCE_INTERNAL;
	if (HAL_TIM_ConfigClockSource(&htim4, &sClockSourceConfig) != HAL_OK) {
		Error_Handler();
	}
	if (HAL_TIM_PWM_Init(&htim4) != HAL_OK) {
		Error_Handler();
	}
	sMasterConfig.MasterOutputTrigger = TIM_TRGO_RESET;
	sMasterConfig.MasterSlaveMode = TIM_MASTERSLAVEMODE_DISABLE;
	if (HAL_TIMEx_MasterConfigSynchronization(&htim4, &sMasterConfig)
			!= HAL_OK) {
		Error_Handler();
	}
	sConfigOC.OCMode = TIM_OCMODE_PWM1;
	sConfigOC.Pulse = 0;
	sConfigOC.OCPolarity = TIM_OCPOLARITY_HIGH;
	sConfigOC.OCFastMode = TIM_OCFAST_DISABLE;
	if (HAL_TIM_PWM_ConfigChannel(&htim4, &sConfigOC, TIM_CHANNEL_1)
			!= HAL_OK) {
		Error_Handler();
	}
	if (HAL_TIM_PWM_ConfigChannel(&htim4, &sConfigOC, TIM_CHANNEL_2)
			!= HAL_OK) {
		Error_Handler();
	}
	HAL_TIM_MspPostInit(&htim4);

}

static void MX_TIM5_Init(void) {

	TIM_ClockConfigTypeDef sClockSourceConfig = { 0 };
	TIM_MasterConfigTypeDef sMasterConfig = { 0 };
	TIM_OC_InitTypeDef sConfigOC = { 0 };

	htim5.Instance = TIM5;
	htim5.Init.Prescaler = 0;
	htim5.Init.CounterMode = TIM_COUNTERMODE_UP;
	htim5.Init.Period = 4294967295;
	htim5.Init.ClockDivision = TIM_CLOCKDIVISION_DIV1;
	htim5.Init.AutoReloadPreload = TIM_AUTORELOAD_PRELOAD_DISABLE;
	if (HAL_TIM_Base_Init(&htim5) != HAL_OK) {
		Error_Handler();
	}
	sClockSourceConfig.ClockSource = TIM_CLOCKSOURCE_INTERNAL;
	if (HAL_TIM_ConfigClockSource(&htim5, &sClockSourceConfig) != HAL_OK) {
		Error_Handler();
	}
	if (HAL_TIM_PWM_Init(&htim5) != HAL_OK) {
		Error_Handler();
	}
	sMasterConfig.MasterOutputTrigger = TIM_TRGO_RESET;
	sMasterConfig.MasterSlaveMode = TIM_MASTERSLAVEMODE_DISABLE;
	if (HAL_TIMEx_MasterConfigSynchronization(&htim5, &sMasterConfig)
			!= HAL_OK) {
		Error_Handler();
	}
	sConfigOC.OCMode = TIM_OCMODE_PWM1;
	sConfigOC.Pulse = 0;
	sConfigOC.OCPolarity = TIM_OCPOLARITY_HIGH;
	sConfigOC.OCFastMode = TIM_OCFAST_DISABLE;
	if (HAL_TIM_PWM_ConfigChannel(&htim5, &sConfigOC, TIM_CHANNEL_1)
			!= HAL_OK) {
		Error_Handler();
	}
	HAL_TIM_MspPostInit(&htim5);

}

static void MX_TIM8_Init(void) {

	TIM_ClockConfigTypeDef sClockSourceConfig = { 0 };
	TIM_MasterConfigTypeDef sMasterConfig = { 0 };
	TIM_OC_InitTypeDef sConfigOC = { 0 };
	TIM_BreakDeadTimeConfigTypeDef sBreakDeadTimeConfig = { 0 };

	htim8.Instance = TIM8;
	htim8.Init.Prescaler = 0;
	htim8.Init.CounterMode = TIM_COUNTERMODE_UP;
	htim8.Init.Period = 65535;
	htim8.Init.ClockDivision = TIM_CLOCKDIVISION_DIV1;
	htim8.Init.RepetitionCounter = 0;
	htim8.Init.AutoReloadPreload = TIM_AUTORELOAD_PRELOAD_DISABLE;
	if (HAL_TIM_Base_Init(&htim8) != HAL_OK) {
		Error_Handler();
	}
	sClockSourceConfig.ClockSource = TIM_CLOCKSOURCE_INTERNAL;
	if (HAL_TIM_ConfigClockSource(&htim8, &sClockSourceConfig) != HAL_OK) {
		Error_Handler();
	}
	if (HAL_TIM_PWM_Init(&htim8) != HAL_OK) {
		Error_Handler();
	}
	sMasterConfig.MasterOutputTrigger = TIM_TRGO_RESET;
	sMasterConfig.MasterSlaveMode = TIM_MASTERSLAVEMODE_DISABLE;
	if (HAL_TIMEx_MasterConfigSynchronization(&htim8, &sMasterConfig)
			!= HAL_OK) {
		Error_Handler();
	}
	sConfigOC.OCMode = TIM_OCMODE_PWM1;
	sConfigOC.Pulse = 0;
	sConfigOC.OCPolarity = TIM_OCPOLARITY_HIGH;
	sConfigOC.OCNPolarity = TIM_OCNPOLARITY_HIGH;
	sConfigOC.OCFastMode = TIM_OCFAST_DISABLE;
	sConfigOC.OCIdleState = TIM_OCIDLESTATE_RESET;
	sConfigOC.OCNIdleState = TIM_OCNIDLESTATE_RESET;
	if (HAL_TIM_PWM_ConfigChannel(&htim8, &sConfigOC, TIM_CHANNEL_1)
			!= HAL_OK) {
		Error_Handler();
	}
	if (HAL_TIM_PWM_ConfigChannel(&htim8, &sConfigOC, TIM_CHANNEL_2)
			!= HAL_OK) {
		Error_Handler();
	}
	sBreakDeadTimeConfig.OffStateRunMode = TIM_OSSR_DISABLE;
	sBreakDeadTimeConfig.OffStateIDLEMode = TIM_OSSI_DISABLE;
	sBreakDeadTimeConfig.LockLevel = TIM_LOCKLEVEL_OFF;
	sBreakDeadTimeConfig.DeadTime = 0;
	sBreakDeadTimeConfig.BreakState = TIM_BREAK_DISABLE;
	sBreakDeadTimeConfig.BreakPolarity = TIM_BREAKPOLARITY_HIGH;
	sBreakDeadTimeConfig.AutomaticOutput = TIM_AUTOMATICOUTPUT_DISABLE;
	if (HAL_TIMEx_ConfigBreakDeadTime(&htim8, &sBreakDeadTimeConfig)
			!= HAL_OK) {
		Error_Handler();
	}
	HAL_TIM_MspPostInit(&htim8);

}

static void MX_TIM9_Init(void) {

	TIM_ClockConfigTypeDef sClockSourceConfig = { 0 };
	TIM_OC_InitTypeDef sConfigOC = { 0 };

	htim9.Instance = TIM9;
	htim9.Init.Prescaler = 0;
	htim9.Init.CounterMode = TIM_COUNTERMODE_UP;
	htim9.Init.Period = 65535;
	htim9.Init.ClockDivision = TIM_CLOCKDIVISION_DIV1;
	htim9.Init.AutoReloadPreload = TIM_AUTORELOAD_PRELOAD_DISABLE;
	if (HAL_TIM_Base_Init(&htim9) != HAL_OK) {
		Error_Handler();
	}
	sClockSourceConfig.ClockSource = TIM_CLOCKSOURCE_INTERNAL;
	if (HAL_TIM_ConfigClockSource(&htim9, &sClockSourceConfig) != HAL_OK) {
		Error_Handler();
	}
	if (HAL_TIM_PWM_Init(&htim9) != HAL_OK) {
		Error_Handler();
	}
	sConfigOC.OCMode = TIM_OCMODE_PWM1;
	sConfigOC.Pulse = 0;
	sConfigOC.OCPolarity = TIM_OCPOLARITY_HIGH;
	sConfigOC.OCFastMode = TIM_OCFAST_DISABLE;
	if (HAL_TIM_PWM_ConfigChannel(&htim9, &sConfigOC, TIM_CHANNEL_1)
			!= HAL_OK) {
		Error_Handler();
	}
	if (HAL_TIM_PWM_ConfigChannel(&htim9, &sConfigOC, TIM_CHANNEL_2)
			!= HAL_OK) {
		Error_Handler();
	}
	HAL_TIM_MspPostInit(&htim9);

}

static void MX_TIM10_Init(void) {

	TIM_OC_InitTypeDef sConfigOC = { 0 };

	htim10.Instance = TIM10;
	htim10.Init.Prescaler = 0;
	htim10.Init.CounterMode = TIM_COUNTERMODE_UP;
	htim10.Init.Period = 65535;
	htim10.Init.ClockDivision = TIM_CLOCKDIVISION_DIV1;
	htim10.Init.AutoReloadPreload = TIM_AUTORELOAD_PRELOAD_DISABLE;
	if (HAL_TIM_Base_Init(&htim10) != HAL_OK) {
		Error_Handler();
	}
	if (HAL_TIM_PWM_Init(&htim10) != HAL_OK) {
		Error_Handler();
	}
	sConfigOC.OCMode = TIM_OCMODE_PWM1;
	sConfigOC.Pulse = 0;
	sConfigOC.OCPolarity = TIM_OCPOLARITY_HIGH;
	sConfigOC.OCFastMode = TIM_OCFAST_DISABLE;
	if (HAL_TIM_PWM_ConfigChannel(&htim10, &sConfigOC, TIM_CHANNEL_1)
			!= HAL_OK) {
		Error_Handler();
	}
	HAL_TIM_MspPostInit(&htim10);

}

static void MX_TIM11_Init(void) {

	TIM_OC_InitTypeDef sConfigOC = { 0 };

	htim11.Instance = TIM11;
	htim11.Init.Prescaler = 0;
	htim11.Init.CounterMode = TIM_COUNTERMODE_UP;
	htim11.Init.Period = 65535;
	htim11.Init.ClockDivision = TIM_CLOCKDIVISION_DIV1;
	htim11.Init.AutoReloadPreload = TIM_AUTORELOAD_PRELOAD_DISABLE;
	if (HAL_TIM_Base_Init(&htim11) != HAL_OK) {
		Error_Handler();
	}
	if (HAL_TIM_PWM_Init(&htim11) != HAL_OK) {
		Error_Handler();
	}
	sConfigOC.OCMode = TIM_OCMODE_PWM1;
	sConfigOC.Pulse = 0;
	sConfigOC.OCPolarity = TIM_OCPOLARITY_HIGH;
	sConfigOC.OCFastMode = TIM_OCFAST_DISABLE;
	if (HAL_TIM_PWM_ConfigChannel(&htim11, &sConfigOC, TIM_CHANNEL_1)
			!= HAL_OK) {
		Error_Handler();
	}
	HAL_TIM_MspPostInit(&htim11);

}

static void MX_TIM12_Init(void) {

	TIM_ClockConfigTypeDef sClockSourceConfig = { 0 };
	TIM_OC_InitTypeDef sConfigOC = { 0 };

	htim12.Instance = TIM12;
	htim12.Init.Prescaler = 0;
	htim12.Init.CounterMode = TIM_COUNTERMODE_UP;
	htim12.Init.Period = 65535;
	htim12.Init.ClockDivision = TIM_CLOCKDIVISION_DIV1;
	htim12.Init.AutoReloadPreload = TIM_AUTORELOAD_PRELOAD_DISABLE;
	if (HAL_TIM_Base_Init(&htim12) != HAL_OK) {
		Error_Handler();
	}
	sClockSourceConfig.ClockSource = TIM_CLOCKSOURCE_INTERNAL;
	if (HAL_TIM_ConfigClockSource(&htim12, &sClockSourceConfig) != HAL_OK) {
		Error_Handler();
	}
	if (HAL_TIM_PWM_Init(&htim12) != HAL_OK) {
		Error_Handler();
	}
	sConfigOC.OCMode = TIM_OCMODE_PWM1;
	sConfigOC.Pulse = 0;
	sConfigOC.OCPolarity = TIM_OCPOLARITY_HIGH;
	sConfigOC.OCFastMode = TIM_OCFAST_DISABLE;
	if (HAL_TIM_PWM_ConfigChannel(&htim12, &sConfigOC, TIM_CHANNEL_1)
			!= HAL_OK) {
		Error_Handler();
	}
	if (HAL_TIM_PWM_ConfigChannel(&htim12, &sConfigOC, TIM_CHANNEL_2)
			!= HAL_OK) {
		Error_Handler();
	}
	HAL_TIM_MspPostInit(&htim12);

}

static void MX_TIM13_Init(void) {

	TIM_OC_InitTypeDef sConfigOC = { 0 };

	htim13.Instance = TIM13;
	htim13.Init.Prescaler = 90 - 1;
	htim13.Init.CounterMode = TIM_COUNTERMODE_UP;
	htim13.Init.Period = 1000 - 1;
	htim13.Init.ClockDivision = TIM_CLOCKDIVISION_DIV1;
	htim13.Init.AutoReloadPreload = TIM_AUTORELOAD_PRELOAD_ENABLE;
	if (HAL_TIM_Base_Init(&htim13) != HAL_OK) {
		Error_Handler();
	}
	if (HAL_TIM_PWM_Init(&htim13) != HAL_OK) {
		Error_Handler();
	}
	sConfigOC.OCMode = TIM_OCMODE_PWM1;
	sConfigOC.Pulse = 0;
	sConfigOC.OCPolarity = TIM_OCPOLARITY_HIGH;
	sConfigOC.OCFastMode = TIM_OCFAST_DISABLE;
	if (HAL_TIM_PWM_ConfigChannel(&htim13, &sConfigOC, TIM_CHANNEL_1)
			!= HAL_OK) {
		Error_Handler();
	}
	HAL_TIM_MspPostInit(&htim13);

}

static void MX_TIM14_Init(void) {

	TIM_OC_InitTypeDef sConfigOC = { 0 };

	htim14.Instance = TIM14;
	htim14.Init.Prescaler = 0;
	htim14.Init.CounterMode = TIM_COUNTERMODE_UP;
	htim14.Init.Period = 65535;
	htim14.Init.ClockDivision = TIM_CLOCKDIVISION_DIV1;
	htim14.Init.AutoReloadPreload = TIM_AUTORELOAD_PRELOAD_DISABLE;
	if (HAL_TIM_Base_Init(&htim14) != HAL_OK) {
		Error_Handler();
	}
	if (HAL_TIM_PWM_Init(&htim14) != HAL_OK) {
		Error_Handler();
	}
	sConfigOC.OCMode = TIM_OCMODE_PWM1;
	sConfigOC.Pulse = 0;
	sConfigOC.OCPolarity = TIM_OCPOLARITY_HIGH;
	sConfigOC.OCFastMode = TIM_OCFAST_DISABLE;
	if (HAL_TIM_PWM_ConfigChannel(&htim14, &sConfigOC, TIM_CHANNEL_1)
			!= HAL_OK) {
		Error_Handler();
	}
	HAL_TIM_MspPostInit(&htim14);

}

static void MX_USART1_UART_Init(void) {

	huart1.Instance = USART1;
	huart1.Init.BaudRate = 115200;
	huart1.Init.WordLength = UART_WORDLENGTH_8B;
	huart1.Init.StopBits = UART_STOPBITS_1;
	huart1.Init.Parity = UART_PARITY_NONE;
	huart1.Init.Mode = UART_MODE_TX_RX;
	huart1.Init.HwFlowCtl = UART_HWCONTROL_NONE;
	huart1.Init.OverSampling = UART_OVERSAMPLING_16;
	if (HAL_UART_Init(&huart1) != HAL_OK) {
		Error_Handler();
	}

}

/* FMC initialization function */
static void MX_FMC_Init(void) {

	FMC_SDRAM_TimingTypeDef SdramTiming = { 0 };

	/** Perform the SDRAM1 memory initialization sequence
	 */
	hsdram1.Instance = FMC_SDRAM_DEVICE;
	/* hsdram1.Init */
	hsdram1.Init.SDBank = FMC_SDRAM_BANK2;
	hsdram1.Init.ColumnBitsNumber = FMC_SDRAM_COLUMN_BITS_NUM_9;
	hsdram1.Init.RowBitsNumber = FMC_SDRAM_ROW_BITS_NUM_13;
	hsdram1.Init.MemoryDataWidth = FMC_SDRAM_MEM_BUS_WIDTH_16;
	hsdram1.Init.InternalBankNumber = FMC_SDRAM_INTERN_BANKS_NUM_4;
	hsdram1.Init.CASLatency = FMC_SDRAM_CAS_LATENCY_3;
	hsdram1.Init.WriteProtection = FMC_SDRAM_WRITE_PROTECTION_DISABLE;
	hsdram1.Init.SDClockPeriod = FMC_SDRAM_CLOCK_PERIOD_2;
	hsdram1.Init.ReadBurst = FMC_SDRAM_RBURST_ENABLE;
	hsdram1.Init.ReadPipeDelay = FMC_SDRAM_RPIPE_DELAY_1;
	/* SdramTiming */
	SdramTiming.LoadToActiveDelay = 2;
	SdramTiming.ExitSelfRefreshDelay = 8;
	SdramTiming.SelfRefreshTime = 6;
	SdramTiming.RowCycleDelay = 7;
	SdramTiming.WriteRecoveryTime = 5;
	SdramTiming.RPDelay = 2;
	SdramTiming.RCDDelay = 2;

	if (HAL_SDRAM_Init(&hsdram1, &SdramTiming) != HAL_OK) {
		Error_Handler();
	}

	/* USER CODE BEGIN FMC_Init 2 */
	FMC_SDRAM_CommandTypeDef command;
	if (SDRAM_Initialization_Sequence(&hsdram1, &command) != HAL_OK) {
		Error_Handler();
	}
	/* USER CODE END FMC_Init 2 */
}

static void MX_GPIO_Init(void) {
	GPIO_InitTypeDef GPIO_InitStruct = { 0 };

	/* GPIO Ports Clock Enable */
	__HAL_RCC_GPIOE_CLK_ENABLE();
	__HAL_RCC_GPIOC_CLK_ENABLE();
	__HAL_RCC_GPIOI_CLK_ENABLE();
	__HAL_RCC_GPIOF_CLK_ENABLE();
	__HAL_RCC_GPIOH_CLK_ENABLE();
	__HAL_RCC_GPIOA_CLK_ENABLE();
	__HAL_RCC_GPIOB_CLK_ENABLE();
	__HAL_RCC_GPIOJ_CLK_ENABLE();
	__HAL_RCC_GPIOG_CLK_ENABLE();
	__HAL_RCC_GPIOD_CLK_ENABLE();
	__HAL_RCC_GPIOK_CLK_ENABLE();

	/*Configure GPIO pin Output Level */
	HAL_GPIO_WritePin(GPIOH, OUT_S0_Pin | OUT_E_Pin, GPIO_PIN_RESET);

	/*Configure GPIO pin Output Level */
	HAL_GPIO_WritePin(GPIOJ,
			MULTISENSE_EN2_Pin | MULTISENSE_EN3_Pin | MULTISENSE_EN4_Pin
					| MULTISENSE_EN5_Pin | MULTISENSE_EN6_Pin | LED_PJ12_Pin
					| LED_PJ13_Pin | LED_PJ14_Pin | LED_PJ15_Pin,
			GPIO_PIN_RESET);

	/*Configure GPIO pin Output Level */
	HAL_GPIO_WritePin(GPIOK,
			MULTISENSE_EN0_Pin | MULTISENSE_EN1_Pin | MULTISENSE_RST_Pin
					| MULTISENSE_SEL0_Pin | MULTISENSE_SEL1_Pin | DET__5V_S1_Pin
					| CAN1_SEL0_Pin | CAN2_SEL0_Pin, GPIO_PIN_RESET);

	/*Configure GPIO pin Output Level */
	HAL_GPIO_WritePin(LED_PI3_GPIO_Port, LED_PI3_Pin, GPIO_PIN_RESET);

	/*Configure GPIO pin Output Level */
	HAL_GPIO_WritePin(GPIOD,
			SD_CS_Pin | PUD_S0_Pin | PUD_S1_Pin | PUD_S2_Pin | PUD_E_Pin,
			GPIO_PIN_RESET);

	/*Configure GPIO pin Output Level */
	HAL_GPIO_WritePin(GPIOG,
			IN_E_Pin | IN_S0_Pin | IN_S1_Pin | IN_S2_Pin | IN_S3_Pin,
			GPIO_PIN_RESET);

	/*Configure GPIO pin Output Level */
	HAL_GPIO_WritePin(SPI1_FLASH_GPIO_Port, SPI1_FLASH_Pin, GPIO_PIN_RESET);

	/*Configure GPIO pins : BTN_1_Pin BTN_2_Pin */
	GPIO_InitStruct.Pin = BTN_1_Pin | BTN_2_Pin;
	GPIO_InitStruct.Mode = GPIO_MODE_INPUT;
	GPIO_InitStruct.Pull = GPIO_NOPULL;
	HAL_GPIO_Init(GPIOE, &GPIO_InitStruct);

	/*Configure GPIO pin : TOUCH_EN_Pin */
	GPIO_InitStruct.Pin = TOUCH_EN_Pin;
	GPIO_InitStruct.Mode = GPIO_MODE_IT_RISING;
	GPIO_InitStruct.Pull = GPIO_PULLDOWN;
	HAL_GPIO_Init(TOUCH_EN_GPIO_Port, &GPIO_InitStruct);

	/*Configure GPIO pin : HALL_OUT_1_PI12_Pin */
	GPIO_InitStruct.Pin = HALL_OUT_1_PI12_Pin;
	GPIO_InitStruct.Mode = GPIO_MODE_INPUT;
	GPIO_InitStruct.Pull = GPIO_NOPULL;
	HAL_GPIO_Init(HALL_OUT_1_PI12_GPIO_Port, &GPIO_InitStruct);

	/*Configure GPIO pins : OUT_S0_Pin OUT_E_Pin */
	GPIO_InitStruct.Pin = OUT_S0_Pin | OUT_E_Pin;
	GPIO_InitStruct.Mode = GPIO_MODE_OUTPUT_PP;
	GPIO_InitStruct.Pull = GPIO_NOPULL;
	GPIO_InitStruct.Speed = GPIO_SPEED_FREQ_LOW;
	HAL_GPIO_Init(GPIOH, &GPIO_InitStruct);

	/*Configure GPIO pins : MULTISENSE_EN2_Pin MULTISENSE_EN3_Pin MULTISENSE_EN4_Pin MULTISENSE_EN5_Pin
	 MULTISENSE_EN6_Pin LED_PJ12_Pin LED_PJ13_Pin LED_PJ14_Pin
	 LED_PJ15_Pin */
	GPIO_InitStruct.Pin = MULTISENSE_EN2_Pin | MULTISENSE_EN3_Pin
			| MULTISENSE_EN4_Pin | MULTISENSE_EN5_Pin | MULTISENSE_EN6_Pin
			| LED_PJ12_Pin | LED_PJ13_Pin | LED_PJ14_Pin | LED_PJ15_Pin;
	GPIO_InitStruct.Mode = GPIO_MODE_OUTPUT_PP;
	GPIO_InitStruct.Pull = GPIO_NOPULL;
	GPIO_InitStruct.Speed = GPIO_SPEED_FREQ_LOW;
	HAL_GPIO_Init(GPIOJ, &GPIO_InitStruct);

	/*Configure GPIO pins : BTN_3_Pin BTN_4_Pin */
	GPIO_InitStruct.Pin = BTN_3_Pin | BTN_4_Pin;
	GPIO_InitStruct.Mode = GPIO_MODE_INPUT;
	GPIO_InitStruct.Pull = GPIO_NOPULL;
	HAL_GPIO_Init(GPIOJ, &GPIO_InitStruct);

	/*Configure GPIO pins : MULTISENSE_EN0_Pin MULTISENSE_EN1_Pin MULTISENSE_RST_Pin MULTISENSE_SEL0_Pin
	 MULTISENSE_SEL1_Pin DET__5V_S1_Pin */
	GPIO_InitStruct.Pin = MULTISENSE_EN0_Pin | MULTISENSE_EN1_Pin
			| MULTISENSE_RST_Pin | MULTISENSE_SEL0_Pin | MULTISENSE_SEL1_Pin
			| DET__5V_S1_Pin;
	GPIO_InitStruct.Mode = GPIO_MODE_OUTPUT_PP;
	GPIO_InitStruct.Pull = GPIO_NOPULL;
	GPIO_InitStruct.Speed = GPIO_SPEED_FREQ_LOW;
	HAL_GPIO_Init(GPIOK, &GPIO_InitStruct);

	/*Configure GPIO pin : SDIO_ENT_Pin */
	GPIO_InitStruct.Pin = SDIO_ENT_Pin;
	GPIO_InitStruct.Mode = GPIO_MODE_INPUT;
	GPIO_InitStruct.Pull = GPIO_NOPULL;
	HAL_GPIO_Init(SDIO_ENT_GPIO_Port, &GPIO_InitStruct);

	/*Configure GPIO pin : LED_PI3_Pin */
	GPIO_InitStruct.Pin = LED_PI3_Pin;
	GPIO_InitStruct.Mode = GPIO_MODE_OUTPUT_PP;
	GPIO_InitStruct.Pull = GPIO_NOPULL;
	GPIO_InitStruct.Speed = GPIO_SPEED_FREQ_LOW;
	HAL_GPIO_Init(LED_PI3_GPIO_Port, &GPIO_InitStruct);

	/*Configure GPIO pin : SD_CS_Pin */
	GPIO_InitStruct.Pin = SD_CS_Pin;
	GPIO_InitStruct.Mode = GPIO_MODE_OUTPUT_PP;
	GPIO_InitStruct.Pull = GPIO_PULLUP;
	GPIO_InitStruct.Speed = GPIO_SPEED_FREQ_LOW;
	HAL_GPIO_Init(SD_CS_GPIO_Port, &GPIO_InitStruct);

	/*Configure GPIO pins : PUD_S0_Pin PUD_S1_Pin PUD_S2_Pin PUD_E_Pin */
	GPIO_InitStruct.Pin = PUD_S0_Pin | PUD_S1_Pin | PUD_S2_Pin | PUD_E_Pin;
	GPIO_InitStruct.Mode = GPIO_MODE_OUTPUT_PP;
	GPIO_InitStruct.Pull = GPIO_NOPULL;
	GPIO_InitStruct.Speed = GPIO_SPEED_FREQ_LOW;
	HAL_GPIO_Init(GPIOD, &GPIO_InitStruct);

	/*Configure GPIO pins : IN_E_Pin IN_S0_Pin IN_S1_Pin IN_S2_Pin
	 IN_S3_Pin */
	GPIO_InitStruct.Pin = IN_E_Pin | IN_S0_Pin | IN_S1_Pin | IN_S2_Pin
			| IN_S3_Pin;
	GPIO_InitStruct.Mode = GPIO_MODE_OUTPUT_PP;
	GPIO_InitStruct.Pull = GPIO_NOPULL;
	GPIO_InitStruct.Speed = GPIO_SPEED_FREQ_LOW;
	HAL_GPIO_Init(GPIOG, &GPIO_InitStruct);

	/*Configure GPIO pins : CAN1_SEL0_Pin CAN2_SEL0_Pin */
	GPIO_InitStruct.Pin = CAN1_SEL0_Pin | CAN2_SEL0_Pin;
	GPIO_InitStruct.Mode = GPIO_MODE_OUTPUT_PP;
	GPIO_InitStruct.Pull = GPIO_PULLDOWN;
	GPIO_InitStruct.Speed = GPIO_SPEED_FREQ_VERY_HIGH;
	HAL_GPIO_Init(GPIOK, &GPIO_InitStruct);

	/*Configure GPIO pin : SPI1_FLASH_Pin */
	GPIO_InitStruct.Pin = SPI1_FLASH_Pin;
	GPIO_InitStruct.Mode = GPIO_MODE_OUTPUT_PP;
	GPIO_InitStruct.Pull = GPIO_NOPULL;
	GPIO_InitStruct.Speed = GPIO_SPEED_FREQ_LOW;
	HAL_GPIO_Init(SPI1_FLASH_GPIO_Port, &GPIO_InitStruct);

	/* EXTI interrupt init*/
	HAL_NVIC_SetPriority(EXTI15_10_IRQn, 5, 0);
	HAL_NVIC_EnableIRQ(EXTI15_10_IRQn);

}

/* USER CODE BEGIN 4 */

float mapFloat(float x, float in_min, float in_max, float out_min,
		float out_max) {
	return (x - in_min) * (out_max - out_min) / (in_max - in_min) + out_min;
}

long mapInt(float x, float in_min, float in_max, int out_min, int out_max) {
	return (int) ((x - in_min) * (out_max - out_min) / (in_max - in_min)
			+ out_min);
}

void HAL_GPIO_EXTI_Callback(uint16_t GPIO_Pin) {
	if (GPIO_Pin == INT_PIN) {
		TOUCH_Set();
	}
}

void CheckAlerts() {

	Dash_Settings.SCREEN_MESSAGE_CONTAINERS[0].Enabled = 0;

	if (Current_Status.RPM >= Dash_Settings.PROTECTION_RPM_HIGH) {
		Dash_Settings.SCREEN_MESSAGE_CONTAINERS[0].Enabled = 1;
		Dash_Settings.SCREEN_MESSAGE_CONTAINERS[0].Background_Color =
				(COLOR_RGB ) { 255, 0, 0 };
		strcpy(Dash_Settings.SCREEN_MESSAGE_CONTAINERS[0].Text,
				"DANGER TO RODS");

	} else if (Current_Status.RPM >= Dash_Settings.PROTECTION_RPM_LOW) {
		Dash_Settings.SCREEN_MESSAGE_CONTAINERS[0].Enabled = 1;
		Dash_Settings.SCREEN_MESSAGE_CONTAINERS[0].Text_Color = (COLOR_RGB ) {
						0, 0, 0 };
		Dash_Settings.SCREEN_MESSAGE_CONTAINERS[0].Background_Color =
				(COLOR_RGB ) { 255, 255, 0 };
		strcpy(Dash_Settings.SCREEN_MESSAGE_CONTAINERS[0].Text,
				"YOU SURE YOU WANT THIS");
	}

	if (Current_Status.ECT > 1200.0) {
		Dash_Settings.SCREEN_CONTAINERS[0].Background_Color = (COLOR_RGB ) {
						255, 0, 0 };
		Dash_Settings.SCREEN_CONTAINERS[0].Value.Text_Color = (COLOR_RGB ) { 0,
						0, 0 };
		Dash_Settings.SCREEN_CONTAINERS[0].Label.Text_Color = (COLOR_RGB ) { 0,
						0, 0 };
		Dash_Settings.SCREEN_CONTAINERS[0].Unit.Text_Color = (COLOR_RGB ) { 0,
						0, 0 };

		Dash_Settings.SCREEN_MESSAGE_CONTAINERS[0].Enabled = 1;
		Dash_Settings.SCREEN_MESSAGE_CONTAINERS[0].Background_Color =
				(COLOR_RGB ) { 255, 0, 0 };
		strcpy(Dash_Settings.SCREEN_MESSAGE_CONTAINERS[0].Text,
				"ENGINE COOLANT °C TOO HIGH");

	} else if (Current_Status.ECT > 1050.0) {
		Dash_Settings.SCREEN_CONTAINERS[0].Background_Color = (COLOR_RGB ) {
						255, 255, 0 };
		Dash_Settings.SCREEN_CONTAINERS[0].Value.Text_Color = (COLOR_RGB ) { 0,
						0, 0 };
		Dash_Settings.SCREEN_CONTAINERS[0].Label.Text_Color = (COLOR_RGB ) { 0,
						0, 0 };
		Dash_Settings.SCREEN_CONTAINERS[0].Unit.Text_Color = (COLOR_RGB ) { 0,
						0, 0 };

		Dash_Settings.SCREEN_MESSAGE_CONTAINERS[0].Enabled = 1;
		Dash_Settings.SCREEN_MESSAGE_CONTAINERS[0].Background_Color =
				(COLOR_RGB ) { 255, 255, 0 };
		strcpy(Dash_Settings.SCREEN_MESSAGE_CONTAINERS[0].Text,
				"ENGINE COOLANT °C HIGH");
	} else {

		Dash_Settings.SCREEN_CONTAINERS[0].Background_Color = (COLOR_RGB ) { 0,
						0, 0 };
		Dash_Settings.SCREEN_CONTAINERS[0].Value.Text_Color = (COLOR_RGB ) {
						255, 255, 255 };
		Dash_Settings.SCREEN_CONTAINERS[0].Label.Text_Color = (COLOR_RGB ) {
						255, 255, 255 };
		Dash_Settings.SCREEN_CONTAINERS[0].Unit.Text_Color = (COLOR_RGB ) { 255,
						255, 255 };
	}

	if (Current_Status.BATT > 1400.0) {
		Dash_Settings.SCREEN_CONTAINERS[5].Background_Color = (COLOR_RGB ) { 0,
						0, 0 };
		Dash_Settings.SCREEN_CONTAINERS[5].Value.Text_Color = (COLOR_RGB ) {
						255, 255, 255 };
		Dash_Settings.SCREEN_CONTAINERS[5].Label.Text_Color = (COLOR_RGB ) {
						255, 255, 255 };
		Dash_Settings.SCREEN_CONTAINERS[5].Unit.Text_Color = (COLOR_RGB ) { 255,
						255, 255 };
	} else if (Current_Status.BATT > 1100.0) {
		Dash_Settings.SCREEN_CONTAINERS[5].Background_Color = (COLOR_RGB ) {
						255, 255, 0 };
		Dash_Settings.SCREEN_CONTAINERS[5].Value.Text_Color = (COLOR_RGB ) { 0,
						0, 0 };
		Dash_Settings.SCREEN_CONTAINERS[5].Label.Text_Color = (COLOR_RGB ) { 0,
						0, 0 };
		Dash_Settings.SCREEN_CONTAINERS[5].Unit.Text_Color = (COLOR_RGB ) { 0,
						0, 0 };
	} else {
		Dash_Settings.SCREEN_CONTAINERS[5].Background_Color = (COLOR_RGB ) {
						255, 0, 0 };
		Dash_Settings.SCREEN_CONTAINERS[5].Value.Text_Color = (COLOR_RGB ) { 0,
						0, 0 };
		Dash_Settings.SCREEN_CONTAINERS[5].Label.Text_Color = (COLOR_RGB ) { 0,
						0, 0 };
		Dash_Settings.SCREEN_CONTAINERS[5].Unit.Text_Color = (COLOR_RGB ) { 0,
						0, 0 };
	}

	if (Current_Status.LAMBDA1 < 900 && Current_Status.LAMBDA1 > 1100) {
		Dash_Settings.SCREEN_CONTAINERS[7].Background_Color = (COLOR_RGB ) {
						255, 0, 0 };
		Dash_Settings.SCREEN_CONTAINERS[7].Value.Text_Color = (COLOR_RGB ) { 0,
						0, 0 };
		Dash_Settings.SCREEN_CONTAINERS[7].Label.Text_Color = (COLOR_RGB ) { 0,
						0, 0 };
		Dash_Settings.SCREEN_CONTAINERS[7].Unit.Text_Color = (COLOR_RGB ) { 0,
						0, 0 };
	} else {
		//Dash_Settings.SCREEN_CONTAINERS[4].Background_Color = (COLOR_RGB ) {255, 255, 0 };
		Dash_Settings.SCREEN_CONTAINERS[7].Value.Text_Color = (COLOR_RGB ) { 0,
						255, 0 };
		//Dash_Settings.SCREEN_CONTAINERS[4].Label.Text_Color = (COLOR_RGB ) {0, 0, 0 };
		//Dash_Settings.SCREEN_CONTAINERS[4].Unit.Text_Color = (COLOR_RGB ) {0, 0, 0 };
	}
}

void Update_Data() {
	for (int i = 0; i < SCREEN_CONTAINERS_COUNT; ++i) {
		switch (Dash_Settings.SCREEN_CONTAINERS[i].Data.Channel) {
		case CH_MGP:
			Dash_Settings.SCREEN_CONTAINERS[i].Data.Value = Current_Status.MGP;
			break;
		case CH_INJ_DC:
			Dash_Settings.SCREEN_CONTAINERS[i].Data.Value =
					Current_Status.INJ_DC;
			break;
		case CH_INJ_DC_ST:
			Dash_Settings.SCREEN_CONTAINERS[i].Data.Value =
					Current_Status.INJ_DC_ST;
			break;
		case CH_INJ_PULSE:
			Dash_Settings.SCREEN_CONTAINERS[i].Data.Value =
					Current_Status.INJ_PULSE;
			break;
		case CH_MAF:
			Dash_Settings.SCREEN_CONTAINERS[i].Data.Value = Current_Status.MAF;
			break;
		case CH_INJ_TIM:
			Dash_Settings.SCREEN_CONTAINERS[i].Data.Value =
					Current_Status.INJ_TIM;
			break;
		case CH_IGN_TIM:
			Dash_Settings.SCREEN_CONTAINERS[i].Data.Value =
					Current_Status.IGN_TIM;
			break;
		case CH_CAM_I_L:
			Dash_Settings.SCREEN_CONTAINERS[i].Data.Value =
					Current_Status.CAM_I_L;
			break;
		case CH_CAM_I_R:
			Dash_Settings.SCREEN_CONTAINERS[i].Data.Value =
					Current_Status.CAM_I_R;
			break;
		case CH_CAM_E_L:
			Dash_Settings.SCREEN_CONTAINERS[i].Data.Value =
					Current_Status.CAM_E_L;
			break;
		case CH_CAM_E_R:
			Dash_Settings.SCREEN_CONTAINERS[i].Data.Value =
					Current_Status.CAM_E_R;
			break;
		case CH_LAMBDA1:
			Dash_Settings.SCREEN_CONTAINERS[i].Data.Value =
					Current_Status.LAMBDA1;
			break;
		case CH_LAMBDA2:
			Dash_Settings.SCREEN_CONTAINERS[i].Data.Value =
					Current_Status.LAMBDA2;
			break;
		case CH_TRIG1_ERROR:
			Dash_Settings.SCREEN_CONTAINERS[i].Data.Value =
					Current_Status.TRIG1_ERROR;
			break;
		case CH_FAULT_CODES:
			Dash_Settings.SCREEN_CONTAINERS[i].Data.Value =
					Current_Status.FAULT_CODES;
			break;
		case CH_LF_SPEED:
			Dash_Settings.SCREEN_CONTAINERS[i].Data.Value =
					Current_Status.LF_SPEED;
			break;
		case CH_LR_SPEED:
			Dash_Settings.SCREEN_CONTAINERS[i].Data.Value =
					Current_Status.LR_SPEED;
			break;
		case CH_RF_SPEED:
			Dash_Settings.SCREEN_CONTAINERS[i].Data.Value =
					Current_Status.RF_SPEED;
			break;
		case CH_RR_SPEED:
			Dash_Settings.SCREEN_CONTAINERS[i].Data.Value =
					Current_Status.RR_SPEED;
			break;
		case CH_KNOCK1:
			Dash_Settings.SCREEN_CONTAINERS[i].Data.Value =
					Current_Status.KNOCK1;
			break;
		case CH_KNOCK2:
			Dash_Settings.SCREEN_CONTAINERS[i].Data.Value =
					Current_Status.KNOCK2;
			break;
		case CH_KNOCK3:
			Dash_Settings.SCREEN_CONTAINERS[i].Data.Value =
					Current_Status.KNOCK3;
			break;
		case CH_KNOCK4:
			Dash_Settings.SCREEN_CONTAINERS[i].Data.Value =
					Current_Status.KNOCK4;
			break;
		case CH_KNOCK5:
			Dash_Settings.SCREEN_CONTAINERS[i].Data.Value =
					Current_Status.KNOCK5;
			break;
		case CH_KNOCK6:
			Dash_Settings.SCREEN_CONTAINERS[i].Data.Value =
					Current_Status.KNOCK6;
			break;
		case CH_KNOCK7:
			Dash_Settings.SCREEN_CONTAINERS[i].Data.Value =
					Current_Status.KNOCK7;
			break;
		case CH_KNOCK8:
			Dash_Settings.SCREEN_CONTAINERS[i].Data.Value =
					Current_Status.KNOCK8;
			break;
		case CH_LIMITS:
			Dash_Settings.SCREEN_CONTAINERS[i].Data.Value =
					Current_Status.LIMITS;
			break;
		case CH_TPS:
			Dash_Settings.SCREEN_CONTAINERS[i].Data.Value = Current_Status.TPS;
			break;
		case CH_ECT:
			Dash_Settings.SCREEN_CONTAINERS[i].Data.Value = Current_Status.ECT;
			break;
		case CH_IAT:
			Dash_Settings.SCREEN_CONTAINERS[i].Data.Value = Current_Status.IAT;
			break;
		case CH_ETHANOL:
			Dash_Settings.SCREEN_CONTAINERS[i].Data.Value =
					Current_Status.ETHANOL;
			break;
		case CH_MAP:
			Dash_Settings.SCREEN_CONTAINERS[i].Data.Value = Current_Status.MAP;
			break;
		case CH_BARO:
			Dash_Settings.SCREEN_CONTAINERS[i].Data.Value = Current_Status.BARO;
			break;
		case CH_BATT:
			Dash_Settings.SCREEN_CONTAINERS[i].Data.Value = Current_Status.BATT;
			break;
		case CH_FUELP:
			Dash_Settings.SCREEN_CONTAINERS[i].Data.Value =
					Current_Status.FUELP;
			break;
		case CH_OILP:
			Dash_Settings.SCREEN_CONTAINERS[i].Data.Value = Current_Status.OILP;
			break;
		case CH_FUELT:
			Dash_Settings.SCREEN_CONTAINERS[i].Data.Value =
					Current_Status.FUELT;
			break;
		case CH_OILT:
			Dash_Settings.SCREEN_CONTAINERS[i].Data.Value = Current_Status.OILT;
			break;
		case CH_RPM:
			Dash_Settings.SCREEN_CONTAINERS[i].Data.Value = Current_Status.RPM;
			break;
		case CH_FUELL:
			Dash_Settings.SCREEN_CONTAINERS[i].Data.Value =
					Current_Status.FUELLEVEL;
			break;
		default:
			break;
		}
	}
	CheckAlerts();
}

void Update_RPM_Ranges() {
	Current_Status.RPM_100 = mapInt(Current_Status.RPM, 0,
			Dash_Settings.PROTECTION_RPM_HIGH, 0, 100);
	Current_Status.RPM_100 =
			Current_Status.RPM_100 >= 100 ? 100 : Current_Status.RPM_100;
	Current_Status.RPM_180 = mapInt(Current_Status.RPM, 0,
			Dash_Settings.PROTECTION_RPM_HIGH, 0, 180);
	Current_Status.RPM_180 =
			Current_Status.RPM_180 >= 180 ? 810 : Current_Status.RPM_180;
	Current_Status.RPM_270 = mapInt(Current_Status.RPM, 0,
			Dash_Settings.PROTECTION_RPM_HIGH, 0, 270);
	Current_Status.RPM_270 =
			Current_Status.RPM_270 >= 270 ? 270 : Current_Status.RPM_270;
	Current_Status.RPM_240 = mapInt(Current_Status.RPM, 0,
			Dash_Settings.PROTECTION_RPM_HIGH, 0, 240);
	Current_Status.RPM_240 =
			Current_Status.RPM_240 >= 240 ? 240 : Current_Status.RPM_240;
	Current_Status.RPM_360 = mapInt(Current_Status.RPM, 0,
			Dash_Settings.PROTECTION_RPM_HIGH, 0, 360);
	Current_Status.RPM_360 =
			Current_Status.RPM_360 >= 360 ? 360 : Current_Status.RPM_360;

	Update_Data();
}

void Update_RGB() {

	Current_Status.ENGINE_PROTECTION =
			Current_Status.RPM >= Dash_Settings.PROTECTION_RPM_HIGH ? 1 : 0;

	clearWS2812All();
	uint8_t RPMLED = WS2812_LED_N;

	uint16_t lowRange = mapInt(Current_Status.RPM,
			Dash_Settings.PROTECTION_RPM_LOW, 0,
			RPMLED - Dash_Settings.PROTECTION_RPM_LED, 1);
	lowRange =
			lowRange > RPMLED - Dash_Settings.PROTECTION_RPM_LED ?
					RPMLED - Dash_Settings.PROTECTION_RPM_LED : lowRange;
	lowRange = lowRange < 1 ? 1 : lowRange;

	for (int i = 1; i <= lowRange; i++) {
		WS2812_RGB_t color;
		if (Current_Status.ENGINE_PROTECTION == 1) {
			color.red = 0;
			color.green = 255;
			color.blue = 0;
		} else {
			color.red = 0;
			color.green = 255;
			color.blue = 0;
		}
		setWS2812One((RPMLED - i) + (WS2812_LED_N - RPMLED), color);
	}

	if (Current_Status.RPM > Dash_Settings.PROTECTION_RPM_LOW) {
		uint16_t highRange = mapInt(Current_Status.RPM,
				Dash_Settings.PROTECTION_RPM_HIGH,
				Dash_Settings.PROTECTION_RPM_LOW,
				Dash_Settings.PROTECTION_RPM_LED, 1);
		for (int i = 1; i <= highRange; i++) {
			WS2812_RGB_t color;
			color.red = 255;
			color.green = 0;
			color.blue = 0;

			setWS2812One(
					(Dash_Settings.PROTECTION_RPM_LED - i)
							+ (WS2812_LED_N - RPMLED), color);
		}

		if (Current_Status.RPM >= Dash_Settings.PROTECTION_RPM_HIGH) {
			updateWS2812();
			osDelay(50);
			for (int i = 1; i <= highRange; i++) {
				WS2812_RGB_t color;
				color.red = 0;
				color.green = 0;
				color.blue = 0;

				setWS2812One(
						(Dash_Settings.PROTECTION_RPM_LED - i)
								+ (WS2812_LED_N - RPMLED), color);
			}
		}
	}

	updateWS2812();
	HAL_GPIO_TogglePin(LED_PJ14_GPIO_Port, LED_PJ14_Pin);
}

void HAL_CAN_RxFifo0MsgPendingCallback(CAN_HandleTypeDef *hcan) {

	if (hcan->Instance == CAN1) {
		Dash_Settings.CAN1_ACTIVE = true;
	}
	if (hcan->Instance == CAN2) {
		Dash_Settings.CAN2_ACTIVE = true;
	}

	if (HAL_CAN_GetRxMessage(&hcan1, CAN_RX_FIFO0, &RxHeader, RxData)
			== HAL_OK) {
		if (initFinished && Dash_Settings.CAN_ENABLED == 1) {

			HAL_GPIO_TogglePin(LED_PJ15_GPIO_Port, LED_PJ15_Pin);
			switch (Dash_Settings.CAN_PROTOCOL) {
			case CAN_LINK:
				switch (RxHeader.StdId) {
				case 0x7E8:
					switch (RxData[2]) {
					case 0x05: // PID-0x05 Engine coolant temperature , range is -40 to 215 deg C , formula == A-40
						Current_Status.ECT = RxData[3] - 40;
						break;
					case 0x0B: // PID-0x0B , MAP , range is 0 to 255 kPa , Formula == A
						Current_Status.MAP = RxData[3];
						break;
					case 0x0C: // PID-0x0C , RPM  , range is 0 to 16383.75 rpm , Formula == 256A+B / 4
						Current_Status.RPM = (uint16_t) ((RxData[4] << 8)
								+ (RxData[3] & 0x00ff));
						break;
					case 0x0D: // PID-0x0D , Vehicle speed , range is 0 to 255 km/h , formula == A
						Current_Status.LF_SPEED = RxData[3];
						break;
					case 0x0E: // PID-0x0E , Ignition Timing advance, range is -64 to 63.5 BTDC , formula == A/2 - 64
						Current_Status.IGN_TIM = RxData[3] / 2 - 64;
						break;
					case 0x0F: // PID-0x0F , Inlet air temperature , range is -40 to 215 deg C, formula == A-40
						Current_Status.IAT = RxData[3] - 40;
						break;
					case 0x11: // PID-0x11 , TPS percentage, range is 0 to 100 percent, formula == 100/256 A
						Current_Status.TPS = 100 / 256 * RxData[3];
						break;
					case 0x13: // PID-0x13 , oxygen sensors present, A0-A3 == bank1 , A4-A7 == bank2
						break;
					case 0x1C: // PID-0x1C obd standard
						break;
					case 0x20: // PID-0x20 PIDs supported [21-40]
						break;
					case 0x22: // PID-0x22 Fuel /Pressure (Relative to manifold vacuum) , range is 0 to 5177.265 kPa , formula == 0.079(256A+B)
						Current_Status.FUELP = 0.079
								* (256 * (uint16_t) (RxData[4] << 8)
										+ (RxData[3] & 0x00ff));
						break;
					case 0x24: // PID-0x24 O2 sensor2, AB: fuel/air equivalence ratio, CD: voltage ,  Formula == (2/65536)(256A +B) , 8/65536(256C+D) , Range is 0 to <2 and 0 to >8V
						Current_Status.LAMBDA1 = (2 / 65536)
								* (256 * (uint16_t) (RxData[4] << 8)
										+ (RxData[3] & 0x00ff)); // , 8 / 65536 * (256 * (uint16_t)(RxData[5] << 8) + (RxData[6] & 0x00ff));
						break;
					case 0x25: // PID-0x25 O2 sensor2, AB fuel/air equivalence ratio, CD voltage ,  2/65536(256A +B) ,8/65536(256C+D) , range is 0 to <2 and 0 to >8V
						Current_Status.LAMBDA2 = (2 / 65536)
								* (256 * (uint16_t) (RxData[4] << 8)
										+ (RxData[3] & 0x00ff)); // , 8 / 65536 * (256 * (uint16_t)(RxData[5] << 8) + (RxData[6] & 0x00ff));
						break;
					case 0x33: // PID-0x33 Absolute Barometric pressure , range is 0 to 255 kPa , formula == A
						Current_Status.BARO = RxData[3];
						break;
					case 0x40: // PIDs supported [41-60]
						break;
					case 0x42: // PID-0x42 control module voltage, 256A+B / 1000 , range is 0 to 65.535v
						Current_Status.BATT = 256 * (uint16_t) (RxData[4] << 8)
								+ (RxData[3] & 0x00ff) / 1000;
						break;
					case 0x46: // PID-0x46 Ambient Air Temperature , range is -40 to 215 deg C , formula == A-40
						break;
					case 0x52: // PID-0x52 Ethanol fuel % , range is 0 to 100% , formula == (100/255)A
						Current_Status.ETHANOL = 100 / 255 * RxData[3];
						break;
					case 0x5C: // PID-0x5C Engine oil temperature , range is -40 to 210 deg C , formula == A-40
						Current_Status.OILT = RxData[3] - 40;
						break;
					case 0x60: // PIDs supported [61-80]
						break;
					default:
						break;
					}
					break;
				case 0x3E8: // Link Dash
					switch (RxData[0]) {
					case 0:
						Current_Status.RPM = (uint16_t) ((RxData[3] << 8)
								+ (RxData[2] & 0x00ff));
						Current_Status.MAP = (uint16_t) ((RxData[5] << 8)
								+ (RxData[4] & 0x00ff));
						Current_Status.MGP = (uint16_t) ((RxData[7] << 8)
								+ (RxData[6] & 0x00ff));
						break;
					case 1:
						Current_Status.BARO = (uint16_t) ((RxData[3] << 8)
								+ (RxData[2] & 0x00ff));
						Current_Status.TPS = (uint16_t) ((RxData[5] << 8)
								+ (RxData[4] & 0x00ff));
						Current_Status.INJ_DC = (uint16_t) ((RxData[7] << 8)
								+ (RxData[6] & 0x00ff));
						break;
					case 2:
						Current_Status.INJ_DC_ST = (uint16_t) ((RxData[3] << 8)
								+ (RxData[2] & 0x00ff));
						Current_Status.INJ_PULSE = (uint16_t) ((RxData[5] << 8)
								+ (RxData[4] & 0x00ff));
						Current_Status.ECT = (uint16_t) ((RxData[7] << 8)
								+ (RxData[6] & 0x00ff));
						break;
					case 3:
						Current_Status.IAT = (uint16_t) ((RxData[3] << 8)
								+ (RxData[2] & 0x00ff));
						Current_Status.BATT = (uint16_t) ((RxData[5] << 8)
								+ (RxData[4] & 0x00ff));
						Current_Status.MAF = (uint16_t) ((RxData[7] << 8)
								+ (RxData[6] & 0x00ff));
						break;
					case 4:
						Current_Status.GEAR = (uint16_t) ((RxData[3] << 8)
								+ (RxData[2] & 0x00ff));
						Current_Status.INJ_TIM = (uint16_t) ((RxData[5] << 8)
								+ (RxData[4] & 0x00ff));
						Current_Status.IGN_TIM = (uint16_t) ((RxData[7] << 8)
								+ (RxData[6] & 0x00ff));
						break;
					case 5:
						Current_Status.CAM_I_L = (uint16_t) ((RxData[3] << 8)
								+ (RxData[2] & 0x00ff));
						Current_Status.CAM_I_R = (uint16_t) ((RxData[5] << 8)
								+ (RxData[4] & 0x00ff));
						Current_Status.CAM_E_L = (uint16_t) ((RxData[7] << 8)
								+ (RxData[6] & 0x00ff));
						break;
					case 6:
						Current_Status.CAM_E_R = (uint16_t) ((RxData[3] << 8)
								+ (RxData[2] & 0x00ff));
						Current_Status.LAMBDA1 = (uint16_t) ((RxData[5] << 8)
								+ (RxData[4] & 0x00ff));
						Current_Status.LAMBDA2 = (uint16_t) ((RxData[7] << 8)
								+ (RxData[6] & 0x00ff));
						break;
					case 7:
						Current_Status.TRIG1_ERROR =
								(uint16_t) ((RxData[3] << 8)
										+ (RxData[2] & 0x00ff));
						Current_Status.FAULT_CODES =
								(uint16_t) ((RxData[5] << 8)
										+ (RxData[4] & 0x00ff));
						Current_Status.FUELP = (uint16_t) ((RxData[7] << 8)
								+ (RxData[6] & 0x00ff));
						break;
					case 8:
						Current_Status.OILT = (uint16_t) ((RxData[3] << 8)
								+ (RxData[2] & 0x00ff));
						Current_Status.OILP = (uint16_t) ((RxData[5] << 8)
								+ (RxData[4] & 0x00ff));
						Current_Status.LF_SPEED = (uint16_t) ((RxData[7] << 8)
								+ (RxData[6] & 0x00ff));
						break;
					case 9:
						Current_Status.LR_SPEED = (uint16_t) ((RxData[3] << 8)
								+ (RxData[2] & 0x00ff));
						Current_Status.RF_SPEED = (uint16_t) ((RxData[5] << 8)
								+ (RxData[4] & 0x00ff));
						Current_Status.RR_SPEED = (uint16_t) ((RxData[7] << 8)
								+ (RxData[6] & 0x00ff));
						break;
					case 10:
						Current_Status.KNOCK1 = (uint16_t) ((RxData[3] << 8)
								+ (RxData[2] & 0x00ff));
						Current_Status.KNOCK2 = (uint16_t) ((RxData[5] << 8)
								+ (RxData[4] & 0x00ff));
						Current_Status.KNOCK3 = (uint16_t) ((RxData[7] << 8)
								+ (RxData[6] & 0x00ff));
						break;
					case 11:
						Current_Status.KNOCK4 = (uint16_t) ((RxData[3] << 8)
								+ (RxData[2] & 0x00ff));
						Current_Status.KNOCK5 = (uint16_t) ((RxData[5] << 8)
								+ (RxData[4] & 0x00ff));
						Current_Status.KNOCK6 = (uint16_t) ((RxData[7] << 8)
								+ (RxData[6] & 0x00ff));
						break;
					case 12:
						Current_Status.KNOCK7 = (uint16_t) ((RxData[3] << 8)
								+ (RxData[2] & 0x00ff));
						Current_Status.KNOCK8 = (uint16_t) ((RxData[5] << 8)
								+ (RxData[4] & 0x00ff));
						Current_Status.LIMITS = (uint16_t) ((RxData[7] << 8)
								+ (RxData[6] & 0x00ff));
						break;
					}
					break;
				}
				break;
			case CAN_AIM:
				switch (RxHeader.StdId) {
				case 0x5F0:
					Current_Status.RPM = (uint16_t) ((RxData[1] << 8)
							+ (RxData[0] & 0x00ff));
					Current_Status.TPS = (uint16_t) ((RxData[3] << 8)
							+ (RxData[2] & 0x00ff)) / 65;
					break;
				case 0x5F2:
					Current_Status.IAT = (uint16_t) ((RxData[1] << 8)
							+ (RxData[0] & 0x00ff)) / 19 - 450;
					Current_Status.ECT = (uint16_t) ((RxData[3] << 8)
							+ (RxData[2] & 0x00ff)) / 19 - 450;
					Current_Status.FUELT = (uint16_t) ((RxData[5] << 8)
							+ (RxData[4] & 0x00ff)) / 19 - 450;
					Current_Status.OILT = (uint16_t) ((RxData[7] << 8)
							+ (RxData[6] & 0x00ff)) / 19 - 450;
					break;
				case 0x5F3:
					Current_Status.MAP = (uint16_t) ((RxData[1] << 8)
							+ (RxData[0] & 0x00ff)) / 10;
					Current_Status.BARO = (uint16_t) ((RxData[3] << 8)
							+ (RxData[2] & 0x00ff)) / 10;
					Current_Status.OILP = (uint16_t) ((RxData[5] << 8)
							+ (RxData[4] & 0x00ff)) * 100 / 100;
					Current_Status.FUELP = (uint16_t) ((RxData[7] << 8)
							+ (RxData[6] & 0x00ff)) * 100 / 2;
					break;
				case 0x5F4:
					Current_Status.BATT = (uint16_t) ((RxData[3] << 8)
							+ (RxData[2] & 0x00ff)) / 32;
					Current_Status.GEAR = (uint16_t)((RxData[7] << 8) + (RxData[6] & 0x00ff));
					break;
				case 0x5F5:
					//Current_Status.BATT = (uint16_t)((RxData[3] << 8) + (RxData[2] & 0x00ff)) / 32;
					Current_Status.FUELLEVEL = (uint16_t) ((RxData[7] << 8)
							+ (RxData[6] & 0x00ff)) * 100 / 100;
					break;
				case 0x5F6:
					Current_Status.LAMBDA1 = (uint16_t) ((RxData[1] << 8)
							+ (RxData[0] & 0x00ff)) / 2;
					Current_Status.LAMBDA2 = (uint16_t) ((RxData[3] << 8)
							+ (RxData[2] & 0x00ff)) / 2;
					break;
				}
				break;
			default:
				break;
			}

			if (RxHeader.StdId == 0x18A) {
				if (RxData[0] == 0x01) {
					Reset();
				} else if (RxData[0] == 0x02)
					ResetToDFU();
				else if (RxData[0] == 0x04)
					Dash_Settings.SCREEN_CONTAINERS[1].Background_Color =
							(COLOR_RGB ) { 255, 0, 0 };
				else if (RxData[0] == 0x08) {
					setWS2812Brightness(2);
				} else if (RxData[0] == 0x10) {
					setWS2812Brightness(5);
				} else if (RxData[0] == 0x20) {
					setWS2812Brightness(10);
				} else if (RxData[0] == 0x40) {
					setWS2812Brightness(25);
				} else if (RxData[0] == 0x80) {
					setWS2812Brightness(50);
				} else if (RxData[1] == 0x02) {
					Dash_Settings.LCD_BRIGHTNESS =
							Dash_Settings.LCD_BRIGHTNESS >= 1000 ?
									Dash_Settings.LCD_BRIGHTNESS :
							Dash_Settings.LCD_BRIGHTNESS <= 200 ?
									Dash_Settings.LCD_BRIGHTNESS + 50 :
									Dash_Settings.LCD_BRIGHTNESS + 200;
					Dash_Settings.LCD_BRIGHTNESS_CHANGED = 1;
				} else if (RxData[1] == 0x08) {
					Dash_Settings.LCD_BRIGHTNESS =
							Dash_Settings.LCD_BRIGHTNESS <= 0 ?
									Dash_Settings.LCD_BRIGHTNESS :
							Dash_Settings.LCD_BRIGHTNESS <= 200 ?
									Dash_Settings.LCD_BRIGHTNESS - 50 :
									Dash_Settings.LCD_BRIGHTNESS - 200;
					Dash_Settings.LCD_BRIGHTNESS_CHANGED = 1;
				} else if (RxData[1] == 0x04) {
					Dash_Settings.LCD_BRIGHTNESS = 1000;
					Dash_Settings.LCD_BRIGHTNESS_CHANGED = 1;
				} else if (RxData[1] == 0x01) {
					setWS2812Brightness(100);
				} else {
					Dash_Settings.SCREEN_CONTAINERS[0].Background_Color =
							(COLOR_RGB ) { 0, 0, 0 };
					Dash_Settings.SCREEN_CONTAINERS[1].Background_Color =
							(COLOR_RGB ) { 0, 0, 0 };
					Dash_Settings.SCREEN_CONTAINERS[2].Background_Color =
							(COLOR_RGB ) { 0, 0, 0 };
				}

			}
			Update_RPM_Ranges();
		}
	}
}

void Reset() {
	//switchToBootloader = 0x00;
	NVIC_SystemReset();					//Reset the system
}

void ResetToDFU() {
	SYSCFG->MEMRMP = 0x01;
	switchToBootloader = 0x11;
	NVIC_SystemReset();					//Reset the system
}

void JumpToDFU() {
	switchToBootloader = 0x00;//Reset the variable to prevent being stuck in the bootloader (since a device reset wont change it)

	HAL_RCC_DeInit();
	HAL_DeInit();
	SysTick->CTRL = SysTick->LOAD = SysTick->VAL = 0;
	__HAL_SYSCFG_REMAPMEMORY_SYSTEMFLASH();

	const uint32_t p = (*((uint32_t*) 0x1FFF0000));
	__set_MSP(p);

	void (*SysMemBootJump)(void);
	SysMemBootJump = (void (*)(void)) (*((uint32_t*) 0x1FFF0004));
	SysMemBootJump();
	while (1) {
	}
}

void SetScreen(void) {

	//-----------------------------------------------------------------------------
	//-------------------------------LEFT------------------------------------------
	//-----------------------------------------------------------------------------

	strcpy(Dash_Settings.SCREEN_CONTAINERS[0].Label.Text, "ECT");
	Dash_Settings.SCREEN_CONTAINERS[0].Label.X = 12;
	Dash_Settings.SCREEN_CONTAINERS[0].Label.Y = 85;
	Dash_Settings.SCREEN_CONTAINERS[0].Label.Width = 101;
	Dash_Settings.SCREEN_CONTAINERS[0].Label.Height = 30;
	Dash_Settings.SCREEN_CONTAINERS[0].Label.Alignment = ALIGN_LEFT;
	Dash_Settings.SCREEN_CONTAINERS[0].Label.Text_Color = (COLOR_RGB ) { 255,
					255, 255 };

	strcpy(Dash_Settings.SCREEN_CONTAINERS[0].Unit.Text, "°C");
	Dash_Settings.SCREEN_CONTAINERS[0].Unit.X = 150;
	Dash_Settings.SCREEN_CONTAINERS[0].Unit.Y = 85;
	Dash_Settings.SCREEN_CONTAINERS[0].Unit.Width = 101;
	Dash_Settings.SCREEN_CONTAINERS[0].Unit.Height = 30;
	Dash_Settings.SCREEN_CONTAINERS[0].Unit.Alignment = ALIGN_RIGHT;
	Dash_Settings.SCREEN_CONTAINERS[0].Unit.Text_Color = (COLOR_RGB ) { 255,
					255, 255 };

	strcpy(Dash_Settings.SCREEN_CONTAINERS[0].Value.Text, "0");
	Dash_Settings.SCREEN_CONTAINERS[0].Value.X = 12;
	Dash_Settings.SCREEN_CONTAINERS[0].Value.Y = -5;
	Dash_Settings.SCREEN_CONTAINERS[0].Value.Width = 44;
	Dash_Settings.SCREEN_CONTAINERS[0].Value.Height = 96;
	Dash_Settings.SCREEN_CONTAINERS[0].Value.Alignment = ALIGN_LEFT;
	Dash_Settings.SCREEN_CONTAINERS[0].Value.Text_Color = (COLOR_RGB ) { 255,
					255, 255 };

	Dash_Settings.SCREEN_CONTAINERS[0].Data.Channel = CH_ECT;
	Dash_Settings.SCREEN_CONTAINERS[0].Data.Adder = 0;
	Dash_Settings.SCREEN_CONTAINERS[0].Data.Decimal = 0;
	Dash_Settings.SCREEN_CONTAINERS[0].Data.Divider = 10;
	Dash_Settings.SCREEN_CONTAINERS[0].Data.Default = 0;

	//-----------------------------------------------------------------------------

	strcpy(Dash_Settings.SCREEN_CONTAINERS[1].Label.Text, "IAT");
	Dash_Settings.SCREEN_CONTAINERS[1].Label.X = 12;
	Dash_Settings.SCREEN_CONTAINERS[1].Label.Y = 88;
	Dash_Settings.SCREEN_CONTAINERS[1].Label.Width = 101;
	Dash_Settings.SCREEN_CONTAINERS[1].Label.Height = 30;
	Dash_Settings.SCREEN_CONTAINERS[1].Label.Alignment = ALIGN_LEFT;
	Dash_Settings.SCREEN_CONTAINERS[1].Label.Text_Color = (COLOR_RGB ) { 255,
					255, 255 };

	strcpy(Dash_Settings.SCREEN_CONTAINERS[1].Unit.Text, "°C");
	Dash_Settings.SCREEN_CONTAINERS[1].Unit.X = 100;
	Dash_Settings.SCREEN_CONTAINERS[1].Unit.Y = 88;
	Dash_Settings.SCREEN_CONTAINERS[1].Unit.Width = 101;
	Dash_Settings.SCREEN_CONTAINERS[1].Unit.Height = 30;
	Dash_Settings.SCREEN_CONTAINERS[1].Unit.Alignment = ALIGN_RIGHT;
	Dash_Settings.SCREEN_CONTAINERS[1].Unit.Text_Color = (COLOR_RGB ) { 255,
					255, 255 };

	strcpy(Dash_Settings.SCREEN_CONTAINERS[1].Value.Text, "0");
	Dash_Settings.SCREEN_CONTAINERS[1].Value.X = 12;
	Dash_Settings.SCREEN_CONTAINERS[1].Value.Y = -5;
	Dash_Settings.SCREEN_CONTAINERS[1].Value.Width = 44;
	Dash_Settings.SCREEN_CONTAINERS[1].Value.Height = 96;
	Dash_Settings.SCREEN_CONTAINERS[1].Value.Alignment = ALIGN_LEFT;
	Dash_Settings.SCREEN_CONTAINERS[1].Value.Text_Color = (COLOR_RGB ) { 255,
					255, 255 };

	Dash_Settings.SCREEN_CONTAINERS[1].Data.Channel = CH_IAT;
	Dash_Settings.SCREEN_CONTAINERS[1].Data.Adder = 0;
	Dash_Settings.SCREEN_CONTAINERS[1].Data.Decimal = 0;
	Dash_Settings.SCREEN_CONTAINERS[1].Data.Divider = 10;
	Dash_Settings.SCREEN_CONTAINERS[1].Data.Default = 0;

	//-----------------------------------------------------------------------------

	strcpy(Dash_Settings.SCREEN_CONTAINERS[2].Label.Text, "OIL Press");
	Dash_Settings.SCREEN_CONTAINERS[2].Label.X = 12;
	Dash_Settings.SCREEN_CONTAINERS[2].Label.Y = 88;
	Dash_Settings.SCREEN_CONTAINERS[2].Label.Width = 101;
	Dash_Settings.SCREEN_CONTAINERS[2].Label.Height = 30;
	Dash_Settings.SCREEN_CONTAINERS[2].Label.Alignment = ALIGN_LEFT;
	Dash_Settings.SCREEN_CONTAINERS[2].Label.Text_Color = (COLOR_RGB ) { 255,
					255, 255 };

	strcpy(Dash_Settings.SCREEN_CONTAINERS[2].Unit.Text, "kPa");
	Dash_Settings.SCREEN_CONTAINERS[2].Unit.X = 120;
	Dash_Settings.SCREEN_CONTAINERS[2].Unit.Y = 88;
	Dash_Settings.SCREEN_CONTAINERS[2].Unit.Width = 101;
	Dash_Settings.SCREEN_CONTAINERS[2].Unit.Height = 30;
	Dash_Settings.SCREEN_CONTAINERS[2].Unit.Alignment = ALIGN_RIGHT;
	Dash_Settings.SCREEN_CONTAINERS[2].Unit.Text_Color = (COLOR_RGB ) { 255,
					255, 255 };

	strcpy(Dash_Settings.SCREEN_CONTAINERS[2].Value.Text, "0");
	Dash_Settings.SCREEN_CONTAINERS[2].Value.X = 12;
	Dash_Settings.SCREEN_CONTAINERS[2].Value.Y = -5;
	Dash_Settings.SCREEN_CONTAINERS[2].Value.Width = 44;
	Dash_Settings.SCREEN_CONTAINERS[2].Value.Height = 96;
	Dash_Settings.SCREEN_CONTAINERS[2].Value.Alignment = ALIGN_LEFT;
	Dash_Settings.SCREEN_CONTAINERS[2].Value.Text_Color = (COLOR_RGB ) { 255,
					255, 255 };

	Dash_Settings.SCREEN_CONTAINERS[2].Data.Channel = CH_OILP;
	Dash_Settings.SCREEN_CONTAINERS[2].Data.Adder = 0;
	Dash_Settings.SCREEN_CONTAINERS[2].Data.Decimal = 0;
	Dash_Settings.SCREEN_CONTAINERS[2].Data.Divider = 10;
	Dash_Settings.SCREEN_CONTAINERS[2].Data.Default = 0;

	//-----------------------------------------------------------------------------

	strcpy(Dash_Settings.SCREEN_CONTAINERS[3].Label.Text, "FUEL Press");
	Dash_Settings.SCREEN_CONTAINERS[3].Label.X = 12;
	Dash_Settings.SCREEN_CONTAINERS[3].Label.Y = 88;
	Dash_Settings.SCREEN_CONTAINERS[3].Label.Width = 101;
	Dash_Settings.SCREEN_CONTAINERS[3].Label.Height = 30;
	Dash_Settings.SCREEN_CONTAINERS[3].Label.Alignment = ALIGN_LEFT;
	Dash_Settings.SCREEN_CONTAINERS[3].Label.Text_Color = (COLOR_RGB ) { 255,
					255, 255 };

	strcpy(Dash_Settings.SCREEN_CONTAINERS[3].Unit.Text, "kPa");
	Dash_Settings.SCREEN_CONTAINERS[3].Unit.X = 250;
	Dash_Settings.SCREEN_CONTAINERS[3].Unit.Y = 88;
	Dash_Settings.SCREEN_CONTAINERS[3].Unit.Width = 101;
	Dash_Settings.SCREEN_CONTAINERS[3].Unit.Height = 30;
	Dash_Settings.SCREEN_CONTAINERS[3].Unit.Alignment = ALIGN_RIGHT;
	Dash_Settings.SCREEN_CONTAINERS[3].Unit.Text_Color = (COLOR_RGB ) { 255,
					255, 255 };

	strcpy(Dash_Settings.SCREEN_CONTAINERS[3].Value.Text, "0");
	Dash_Settings.SCREEN_CONTAINERS[3].Value.X = 12;
	Dash_Settings.SCREEN_CONTAINERS[3].Value.Y = -5;
	Dash_Settings.SCREEN_CONTAINERS[3].Value.Width = 44;
	Dash_Settings.SCREEN_CONTAINERS[3].Value.Height = 96;
	Dash_Settings.SCREEN_CONTAINERS[3].Value.Alignment = ALIGN_LEFT;
	Dash_Settings.SCREEN_CONTAINERS[3].Value.Text_Color = (COLOR_RGB ) { 255,
					255, 255 };

	Dash_Settings.SCREEN_CONTAINERS[3].Data.Channel = CH_FUELP;
	Dash_Settings.SCREEN_CONTAINERS[3].Data.Adder = 0;
	Dash_Settings.SCREEN_CONTAINERS[3].Data.Decimal = 0;
	Dash_Settings.SCREEN_CONTAINERS[3].Data.Divider = 10;
	Dash_Settings.SCREEN_CONTAINERS[3].Data.Default = 0;

	//-----------------------------------------------------------------------------
	//-------------------------------RIGHT-----------------------------------------
	//-----------------------------------------------------------------------------

	strcpy(Dash_Settings.SCREEN_CONTAINERS[4].Label.Text, "MAP");
	Dash_Settings.SCREEN_CONTAINERS[4].Label.X = 315;
	Dash_Settings.SCREEN_CONTAINERS[4].Label.Y = 88;
	Dash_Settings.SCREEN_CONTAINERS[4].Label.Width = 101;
	Dash_Settings.SCREEN_CONTAINERS[4].Label.Height = 30;
	Dash_Settings.SCREEN_CONTAINERS[4].Label.Alignment = ALIGN_RIGHT;
	Dash_Settings.SCREEN_CONTAINERS[4].Label.Text_Color = (COLOR_RGB ) { 255,
					255, 255 };

	strcpy(Dash_Settings.SCREEN_CONTAINERS[4].Unit.Text, "kPa");
	Dash_Settings.SCREEN_CONTAINERS[4].Unit.X = 210;
	Dash_Settings.SCREEN_CONTAINERS[4].Unit.Y = 88;
	Dash_Settings.SCREEN_CONTAINERS[4].Unit.Width = 101;
	Dash_Settings.SCREEN_CONTAINERS[4].Unit.Height = 30;
	Dash_Settings.SCREEN_CONTAINERS[4].Unit.Alignment = ALIGN_LEFT;
	Dash_Settings.SCREEN_CONTAINERS[4].Unit.Text_Color = (COLOR_RGB ) { 255,
					255, 255 };

	strcpy(Dash_Settings.SCREEN_CONTAINERS[4].Value.Text, "0");
	Dash_Settings.SCREEN_CONTAINERS[4].Value.X = 370;
	Dash_Settings.SCREEN_CONTAINERS[4].Value.Y = -5;
	Dash_Settings.SCREEN_CONTAINERS[4].Value.Width = 44;
	Dash_Settings.SCREEN_CONTAINERS[4].Value.Height = 96;
	Dash_Settings.SCREEN_CONTAINERS[4].Value.Alignment = ALIGN_RIGHT;
	Dash_Settings.SCREEN_CONTAINERS[4].Value.Text_Color = (COLOR_RGB ) { 255,
					255, 255 };

	Dash_Settings.SCREEN_CONTAINERS[4].Data.Channel = CH_MAP;
	Dash_Settings.SCREEN_CONTAINERS[4].Data.Adder = 0;
	Dash_Settings.SCREEN_CONTAINERS[4].Data.Decimal = 0;
	Dash_Settings.SCREEN_CONTAINERS[4].Data.Divider = 10;
	Dash_Settings.SCREEN_CONTAINERS[4].Data.Default = 0;

	//-----------------------------------------------------------------------------

	strcpy(Dash_Settings.SCREEN_CONTAINERS[5].Label.Text, "Battery");
	Dash_Settings.SCREEN_CONTAINERS[5].Label.X = 315;
	Dash_Settings.SCREEN_CONTAINERS[5].Label.Y = 88;
	Dash_Settings.SCREEN_CONTAINERS[5].Label.Width = 101;
	Dash_Settings.SCREEN_CONTAINERS[5].Label.Height = 30;
	Dash_Settings.SCREEN_CONTAINERS[5].Label.Alignment = ALIGN_RIGHT;
	Dash_Settings.SCREEN_CONTAINERS[5].Label.Text_Color = (COLOR_RGB ) { 255,
					255, 255 };

	strcpy(Dash_Settings.SCREEN_CONTAINERS[5].Unit.Text, "V");
	Dash_Settings.SCREEN_CONTAINERS[5].Unit.X = 260;
	Dash_Settings.SCREEN_CONTAINERS[5].Unit.Y = 88;
	Dash_Settings.SCREEN_CONTAINERS[5].Unit.Width = 101;
	Dash_Settings.SCREEN_CONTAINERS[5].Unit.Height = 30;
	Dash_Settings.SCREEN_CONTAINERS[5].Unit.Alignment = ALIGN_LEFT;
	Dash_Settings.SCREEN_CONTAINERS[5].Unit.Text_Color = (COLOR_RGB ) { 255,
					255, 255 };

	strcpy(Dash_Settings.SCREEN_CONTAINERS[5].Value.Text, "0");
	Dash_Settings.SCREEN_CONTAINERS[5].Value.X = 370;
	Dash_Settings.SCREEN_CONTAINERS[5].Value.Y = -5;
	Dash_Settings.SCREEN_CONTAINERS[5].Value.Width = 44;
	Dash_Settings.SCREEN_CONTAINERS[5].Value.Height = 96;
	Dash_Settings.SCREEN_CONTAINERS[5].Value.Alignment = ALIGN_RIGHT;
	Dash_Settings.SCREEN_CONTAINERS[5].Value.Text_Color = (COLOR_RGB ) { 255,
					255, 255 };

	Dash_Settings.SCREEN_CONTAINERS[5].Data.Channel = CH_BATT;
	Dash_Settings.SCREEN_CONTAINERS[5].Data.Adder = 0;
	Dash_Settings.SCREEN_CONTAINERS[5].Data.Decimal = 1;
	Dash_Settings.SCREEN_CONTAINERS[5].Data.Divider = 100;
	Dash_Settings.SCREEN_CONTAINERS[5].Data.Default = 0;

	//-----------------------------------------------------------------------------

	strcpy(Dash_Settings.SCREEN_CONTAINERS[6].Label.Text, "TPS");
	Dash_Settings.SCREEN_CONTAINERS[6].Label.X = 315;
	Dash_Settings.SCREEN_CONTAINERS[6].Label.Y = 88;
	Dash_Settings.SCREEN_CONTAINERS[6].Label.Width = 101;
	Dash_Settings.SCREEN_CONTAINERS[6].Label.Height = 30;
	Dash_Settings.SCREEN_CONTAINERS[6].Label.Alignment = ALIGN_RIGHT;
	Dash_Settings.SCREEN_CONTAINERS[6].Label.Text_Color = (COLOR_RGB ) { 255,
					255, 255 };

	strcpy(Dash_Settings.SCREEN_CONTAINERS[6].Unit.Text, "%");
	Dash_Settings.SCREEN_CONTAINERS[6].Unit.X = 240;
	Dash_Settings.SCREEN_CONTAINERS[6].Unit.Y = 88;
	Dash_Settings.SCREEN_CONTAINERS[6].Unit.Width = 101;
	Dash_Settings.SCREEN_CONTAINERS[6].Unit.Height = 30;
	Dash_Settings.SCREEN_CONTAINERS[6].Unit.Alignment = ALIGN_LEFT;
	Dash_Settings.SCREEN_CONTAINERS[6].Unit.Text_Color = (COLOR_RGB ) { 255,
					255, 255 };

	strcpy(Dash_Settings.SCREEN_CONTAINERS[6].Value.Text, "0");
	Dash_Settings.SCREEN_CONTAINERS[6].Value.X = 370;
	Dash_Settings.SCREEN_CONTAINERS[6].Value.Y = -5;
	Dash_Settings.SCREEN_CONTAINERS[6].Value.Width = 44;
	Dash_Settings.SCREEN_CONTAINERS[6].Value.Height = 96;
	Dash_Settings.SCREEN_CONTAINERS[6].Value.Alignment = ALIGN_RIGHT;
	Dash_Settings.SCREEN_CONTAINERS[6].Value.Text_Color = (COLOR_RGB ) { 255,
					255, 255 };

	Dash_Settings.SCREEN_CONTAINERS[6].Data.Channel = CH_TPS;
	Dash_Settings.SCREEN_CONTAINERS[6].Data.Adder = 0;
	Dash_Settings.SCREEN_CONTAINERS[6].Data.Decimal = 0;
	Dash_Settings.SCREEN_CONTAINERS[6].Data.Divider = 10;
	Dash_Settings.SCREEN_CONTAINERS[6].Data.Default = 0;

	//-----------------------------------------------------------------------------

	strcpy(Dash_Settings.SCREEN_CONTAINERS[7].Label.Text, "Wideband");
	Dash_Settings.SCREEN_CONTAINERS[7].Label.X = 315;
	Dash_Settings.SCREEN_CONTAINERS[7].Label.Y = 88;
	Dash_Settings.SCREEN_CONTAINERS[7].Label.Width = 101;
	Dash_Settings.SCREEN_CONTAINERS[7].Label.Height = 30;
	Dash_Settings.SCREEN_CONTAINERS[7].Label.Alignment = ALIGN_RIGHT;
	Dash_Settings.SCREEN_CONTAINERS[7].Label.Text_Color = (COLOR_RGB ) { 255,
					255, 255 };

	strcpy(Dash_Settings.SCREEN_CONTAINERS[7].Unit.Text, "Lambda");
	Dash_Settings.SCREEN_CONTAINERS[7].Unit.X = 115;
	Dash_Settings.SCREEN_CONTAINERS[7].Unit.Y = 88;
	Dash_Settings.SCREEN_CONTAINERS[7].Unit.Width = 101;
	Dash_Settings.SCREEN_CONTAINERS[7].Unit.Height = 30;
	Dash_Settings.SCREEN_CONTAINERS[7].Unit.Alignment = ALIGN_LEFT;
	Dash_Settings.SCREEN_CONTAINERS[7].Unit.Text_Color = (COLOR_RGB ) { 255,
					255, 255 };

	strcpy(Dash_Settings.SCREEN_CONTAINERS[7].Value.Text, "0");
	Dash_Settings.SCREEN_CONTAINERS[7].Value.X = 370;
	Dash_Settings.SCREEN_CONTAINERS[7].Value.Y = -5;
	Dash_Settings.SCREEN_CONTAINERS[7].Value.Width = 44;
	Dash_Settings.SCREEN_CONTAINERS[7].Value.Height = 96;
	Dash_Settings.SCREEN_CONTAINERS[7].Value.Alignment = ALIGN_RIGHT;
	Dash_Settings.SCREEN_CONTAINERS[7].Value.Text_Color = (COLOR_RGB ) { 255, 0,
					0 };

	Dash_Settings.SCREEN_CONTAINERS[7].Data.Channel = CH_LAMBDA1;
	Dash_Settings.SCREEN_CONTAINERS[7].Data.Adder = 0;
	Dash_Settings.SCREEN_CONTAINERS[7].Data.Decimal = 2;
	Dash_Settings.SCREEN_CONTAINERS[7].Data.Divider = 1000;
	Dash_Settings.SCREEN_CONTAINERS[7].Data.Default = 0;

	//-----------------------------------------------------------------------------

	Dash_Settings.SCREEN_MESSAGE_CONTAINERS[0].Enabled = 1;
	strcpy(Dash_Settings.SCREEN_MESSAGE_CONTAINERS[0].Text,
			"Test Error Message");
	Dash_Settings.SCREEN_MESSAGE_CONTAINERS[0].Alignment = ALIGN_CENTER;
	Dash_Settings.SCREEN_MESSAGE_CONTAINERS[0].X = 0;
	Dash_Settings.SCREEN_MESSAGE_CONTAINERS[0].Y = 8;
	Dash_Settings.SCREEN_MESSAGE_CONTAINERS[0].Width = 1024;
	Dash_Settings.SCREEN_MESSAGE_CONTAINERS[0].Height = 80;
	Dash_Settings.SCREEN_MESSAGE_CONTAINERS[0].Background_Color = (COLOR_RGB ) {
					255, 0, 0 };
	Dash_Settings.SCREEN_MESSAGE_CONTAINERS[0].Text_Color = (COLOR_RGB ) { 0,
					255, 0 };

	Dash_Settings.SCREEN_FIELDS_CHANGED = 1;
}

void initGrayHillKeypad(void) {

	//INIT Grayhill Keypad

	CAN_TxHeaderTypeDef TxHeader;
	uint8_t TxData[8] = { 0x00, 0x00, 0x00, 0x00, 0x00, 0x00, 0x00, 0x00 };
	uint32_t TxMailbox;

	TxHeader.IDE = CAN_ID_STD;
	TxHeader.RTR = CAN_RTR_DATA;
	TxHeader.DLC = 8;

	TxHeader.StdId = 0x000;
	TxData[0] = 0x01;
	HAL_CAN_AddTxMessage(&hcan1, &TxHeader, TxData, &TxMailbox);
	osDelay(10);

	TxHeader.StdId = 0x20A;
	TxData[0] = 0x00;
	HAL_CAN_AddTxMessage(&hcan1, &TxHeader, TxData, &TxMailbox);
	osDelay(10);

	TxHeader.StdId = 0x30A;
	TxData[0] = 0xFF;
	TxData[2] = 0xFF;
	HAL_CAN_AddTxMessage(&hcan1, &TxHeader, TxData, &TxMailbox);
	osDelay(10);
}

void initAll(void) {

	HAL_TIM_PWM_Start(&htim13, TIM_CHANNEL_1);

	Dash_Settings.CAN_ENABLED = 0;
	Dash_Settings.RGB_ENABLED = 1;
	Dash_Settings.RPM_SWEEP = 1;
	Dash_Settings.CAN_PROTOCOL = CAN_AIM;
	Dash_Settings.PRES_UNIT = kPa;
	Dash_Settings.TEMP_UNIT = C;
	Dash_Settings.SPEED_UNIT = Kmh;

	Dash_Settings.PROTECTION_RPM_LOW = 6500;
	Dash_Settings.PROTECTION_RPM_HIGH = 8000;
	Dash_Settings.PROTECTION_RPM_LED = 6;
	Dash_Settings.PROTECTION_OIL_LOW - 40;
	Dash_Settings.PROTECTION_FUEL_LOW = 40;

	Dash_Settings.LCD_BRIGHTNESS = 1000;
	Dash_Settings.LCD_BRIGHTNESS_CHANGED = 1;
	htim13.Instance->CCR1 = Dash_Settings.LCD_BRIGHTNESS;

	initWS2812();

	SetScreen();

	//W25qxx_Init();
	//W25qxx_ReadBlock(&Dash_Settings, (uint32_t) BlockAddress, (uint32_t) Offset,
	//		(uint32_t) sizeof(Dash_Settings));

	//HAL_GPIO_WritePin(CAN1_SEL0_GPIO_Port, CAN1_SEL0_Pin, SET);
	//HAL_GPIO_WritePin(CAN2_SEL0_GPIO_Port, CAN2_SEL0_Pin, SET);

	//INIT Grayhill Keypad
	initGrayHillKeypad();

}

/* USER CODE END 4 */

void Start_START_Task(void *argument) {
	/* init code for USB_DEVICE */
	MX_USB_DEVICE_Init();
	osDelay(250);
	/* USER CODE BEGIN 5 */

	initAll();

	Dash_Settings.ACTIVE_SCREEN = 0;

	osDelay(2000);

	Dash_Settings.ACTIVE_SCREEN = 1;

	osDelay(200);

	if (Dash_Settings.RPM_SWEEP == 1) {
		for (int i = 0; i < Dash_Settings.PROTECTION_RPM_HIGH / 100; ++i) {
			Current_Status.RPM = i * 100;
			Update_RPM_Ranges();
			osDelay(10);
		}
		for (int i = Dash_Settings.PROTECTION_RPM_HIGH / 100; i > 0; --i) {
			Current_Status.RPM = i * 100;
			Update_RPM_Ranges();
			osDelay(10);
		}
	}
	Current_Status.RPM = 0;
	Update_RPM_Ranges();
	Dash_Settings.CAN_ENABLED = 1;
	initFinished = true;

	for (;;) {
		while (!initFinished)
			;
		if (Dash_Settings.LCD_BRIGHTNESS_CHANGED == 1) {
			htim13.Instance->CCR1 = Dash_Settings.LCD_BRIGHTNESS;
			Dash_Settings.LCD_BRIGHTNESS_CHANGED = 0;
		}

		Dash_Settings.CAN1_ACTIVE = false;
		Dash_Settings.CAN2_ACTIVE = false;
		osDelay(100);
	}

	/* USER CODE END 5 */
}

__weak void TouchGFX_Task(void *argument) {
	for (;;) {
		osDelay(1);
	}
}

void Start_LOOKUP_Task(void *argument) {
	/* USER CODE BEGIN Start_LOOKUP_Task */
	/* Infinite loop */
	for (;;) {
		while (!initFinished)
			;
		if (!Dash_Settings.CAN1_ACTIVE) {

			Current_Status.RPM = 0;

			Current_Status.MGP = 0;
			Current_Status.INJ_DC = 0;
			Current_Status.INJ_DC_ST = 0;
			Current_Status.INJ_PULSE = 0;
			Current_Status.MAF = 0;
			Current_Status.INJ_TIM = 0;
			Current_Status.IGN_TIM = 0;
			Current_Status.CAM_I_L = 0;
			Current_Status.CAM_I_R = 0;
			Current_Status.CAM_E_L = 0;
			Current_Status.CAM_E_R = 0;
			Current_Status.LAMBDA1 = 0;
			Current_Status.LAMBDA2 = 0;
			Current_Status.TRIG1_ERROR = 0;
			Current_Status.FAULT_CODES = 0;
			Current_Status.LF_SPEED = 0;
			Current_Status.LR_SPEED = 0;
			Current_Status.RF_SPEED = 0;
			Current_Status.RR_SPEED = 0;
			Current_Status.KNOCK1 = 0;
			Current_Status.KNOCK2 = 0;
			Current_Status.KNOCK3 = 0;
			Current_Status.KNOCK4 = 0;
			Current_Status.KNOCK5 = 0;
			Current_Status.KNOCK6 = 0;
			Current_Status.KNOCK7 = 0;
			Current_Status.KNOCK8 = 0;
			Current_Status.LIMITS = 0;

			Current_Status.TPS = 0;
			Current_Status.ECT = 0;
			Current_Status.IAT = 0;
			Current_Status.ETHANOL = 0;
			Current_Status.MAP = 0;
			Current_Status.BARO = 0;
			Current_Status.BATT = 0;
			Current_Status.FUELP = 0;
			Current_Status.OILP = 0;
			Current_Status.FUELT = 0;
			Current_Status.OILT = 0;

			Current_Status.FUELLEVEL = 0;

			clearWS2812All();
			updateWS2812();

			Update_RPM_Ranges();
			Update_Data();

			Dash_Settings.SCREEN_MESSAGE_CONTAINERS[0].Enabled = 1;
			Dash_Settings.SCREEN_MESSAGE_CONTAINERS[0].Text_Color =
					(COLOR_RGB ) { 0, 0, 0 };
			Dash_Settings.SCREEN_MESSAGE_CONTAINERS[0].Background_Color =
					(COLOR_RGB ) { 255, 255, 0 };
			strcpy(Dash_Settings.SCREEN_MESSAGE_CONTAINERS[0].Text,
					"CONNECTION LOST");

		}

		osDelay(1000);
	}
	/* USER CODE END Start_LOOKUP_Task */
}

void Start_CONFIG_Task(void *argument) {
	/* USER CODE BEGIN Start_CONFIG_Task */
	/* USER CODE BEGIN Start_CONFIG_Task */

	/* Infinite loop */
	for (;;) {
		osDelay(100);

//			switch (USB_RX_Buffer[0]) {
//			case 'S':	//SET
//				switch (USB_RX_Buffer[1]) {
//				case 'C':	//CONTAINER
//					index = ((uint8_t) USB_RX_Buffer[2]) - 48;
//					break;
//				}
//				break;
//			case 'R':	//READ
//				switch (USB_RX_Buffer[1]) {
//					case 'V':	//VERSION
//						switch (USB_RX_Buffer[2]) {
//						case 'H':	//HARDWARE
//						{
//							uint8_t buffer[] = "OPF PDM14\r\n";
//							//CDC_Transmit_FS(buffer, sizeof(buffer));
//						}
//							break;
//						case 'F':	//FIRMWARE
//						{	uint8_t buffer[] = "Version 0.1 beta\r\n";
//							//CDC_Transmit_FS(buffer, sizeof(buffer));
//						}
//							break;
//						case 'B':	//BUILD
//						{	uint8_t buffer[] = "Build 0.1224\r\n";
//							//CDC_Transmit_FS(buffer, sizeof(buffer));
//						}
//							break;
//						}
//						case 'T':	//TYPE
//						{
//							uint8_t buffer[] = "PDM14\r\n";
//							//CDC_Transmit_FS(buffer, sizeof(buffer));
//						}
//							break;
//					break;
//					case 'S':	//STATUS
//						switch (USB_RX_Buffer[2]) {
//						case 'I':	//INPUT
//						{	uint8_t buffer[] = "OPF PDM14\r\n";
//							//CDC_Transmit_FS(buffer, sizeof(buffer));
//						}
//							break;
//						case 'O':	//OUTPUT
//						{	uint8_t buffer[] = "Version 0.1 beta\r\n";
//							//CDC_Transmit_FS(buffer, sizeof(buffer));
//						}
//							break;
//						case 'M':	//MCU
//						{	uint8_t buffer[] = "Build 0.1224\r\n";
//							//CDC_Transmit_FS(buffer, sizeof(buffer));
//						}
//							break;
//						case 'C':	//CAN
//						{	uint8_t buffer[] = "Build 0.1224\r\n";
//							//CDC_Transmit_FS(buffer, sizeof(buffer));
//						}
//							break;
//						}
//					break;
//				}
//				break;
//			case 'W':	//WRITE
//				switch (USB_RX_Buffer[1]) {
//				case 'F':	//FLASH
//					initFinished = false;
//
//					initFinished = true;
//					break;
//				}
//				break;
//			}

	}
	/* USER CODE END Start_CONFIG_Task */
}

void Start_RGB_Task(void *argument) {
	/* USER CODE BEGIN Start_RGB_Task */
	/* Infinite loop */
	for (;;) {
		if (Dash_Settings.RGB_ENABLED == 1) {
			Update_RGB();
		}
		osDelay(50);
	}
	/* USER CODE END Start_RGB_Task */
}

void Start_SD_Task(void *argument) {
	/* USER CODE BEGIN Start_SD_Task */

	osDelay(1000);

	FATFS FatFs; 	//Fatfs handle
	FIL fil; 		//File handle
	FRESULT fres; //Result after operations

	//Open the file system
	fres = f_mount(&FatFs, "", 1); //1=mount now
	if (fres != FR_OK) {

	}

	/* Infinite loop */
	for (;;) {
		osDelay(1);
	}
	/* USER CODE END Start_SD_Task */
}

void Start_HID_SEND_Task(void *argument) {
	/* USER CODE BEGIN Start_HID_SEND_Task */

	uint8_t outData = 0;
	uint8_t USBD_CUSTOM_HID_SendReport(USBD_HandleTypeDef *pdev, uint8_t *report, uint16_t len);

	/* Infinite loop */
	for (;;) {
//		outData = outData > 255 ? 0 : outData + 1;
//
//		for (int index = 2; index < OPF_HID_EPIN_SIZE - 1; ++index) {
//			USB_TX_Buffer[index] = outData;
//		}
//
//		USB_TX_Buffer[0] = 0x01;
//		USB_TX_Buffer[1] = 0x08;
//
//		USBD_CUSTOM_HID_SendReport(&hUsbDeviceFS, USB_TX_Buffer, OPF_HID_EPIN_SIZE);
//		osDelay(1);
//
//		USB_TX_Buffer[0] = 0x02;
//		USBD_CUSTOM_HID_SendReport(&hUsbDeviceFS, USB_TX_Buffer, OPF_HID_EPIN_SIZE);
//		osDelay(1);
//
//		USB_TX_Buffer[0] = 0x03;
//		USBD_CUSTOM_HID_SendReport(&hUsbDeviceFS, USB_TX_Buffer, OPF_HID_EPIN_SIZE);
//		osDelay(1);
//
//		USB_TX_Buffer[0] = 0x04;
//		USBD_CUSTOM_HID_SendReport(&hUsbDeviceFS, USB_TX_Buffer, OPF_HID_EPIN_SIZE);
		osDelay(1000);
	}
	/* USER CODE END Start_HID_SEND_Task */
}

void Start_HID_RECIEVE_Task(void *argument) {
	/* USER CODE BEGIN Start_HID_RECIEVE_Task */
	USB_RX_Ready = 0;

	uint8_t USBD_CUSTOM_HID_ReceivePacket(USBD_HandleTypeDef *pdev);

	HAL_GPIO_WritePin(LED_PJ12_GPIO_Port, LED_PJ12_Pin, SET);
	HAL_GPIO_WritePin(LED_PJ13_GPIO_Port, LED_PJ13_Pin, RESET);

	/* Infinite loop */
	for (;;) {
//		if (USB_RX_Ready == 1) {
//			HAL_GPIO_TogglePin(LED_PJ13_GPIO_Port, LED_PJ13_Pin);
//			HAL_GPIO_TogglePin(LED_PJ12_GPIO_Port, LED_PJ12_Pin);
//
//			uint8_t ACTION = USB_RX_Buffer[0];
//			uint8_t ITEM_ID = USB_RX_Buffer[1];
//			uint8_t CONTAINER = USB_RX_Buffer[2];
//
//			uint8_t CURRENT_BATCH = USB_RX_Buffer[3];
//			uint8_t NUMBER_OF_BATCHES = USB_RX_Buffer[4];
//			uint8_t DATA[64];
//
//			for (int i = 0; i < 64; ++i) {
//				DATA[i] = USB_RX_Buffer[i + 5];
//			}
//
//			switch (ACTION) {
//				//SET CONTAINER
//				case 0x04:
//					//LABEL
//					if(CONTAINER >= 0x00 && CONTAINER <= 0x07)
//					{
//						if (CONTAINER == 0x00) strcpy(Dash_Settings.SCREEN_CONTAINERS[ITEM_ID].Label.Text, "ECT");
//						if (CONTAINER == 0x01) Dash_Settings.SCREEN_CONTAINERS[ITEM_ID].Label.X = 12;
//						if (CONTAINER == 0x02) Dash_Settings.SCREEN_CONTAINERS[ITEM_ID].Label.Y = 85;
//						if (CONTAINER == 0x03) Dash_Settings.SCREEN_CONTAINERS[ITEM_ID].Label.Width = 101;
//						if (CONTAINER == 0x04) Dash_Settings.SCREEN_CONTAINERS[ITEM_ID].Label.Height = 30;
//						if (CONTAINER == 0x05) Dash_Settings.SCREEN_CONTAINERS[ITEM_ID].Label.Alignment =	ALIGN_LEFT;
//						if (CONTAINER == 0x06) Dash_Settings.SCREEN_CONTAINERS[ITEM_ID].Label.Text_Color = (COLOR_RGB ) { 255, 255, 255 };
//						if (CONTAINER == 0x07) ;//UNUSED
//					}
//					//UNIT
//					else if(CONTAINER >= 0x08 && CONTAINER <= 0x0F)
//					{
//						if (CONTAINER == 0x08) strcpy(Dash_Settings.SCREEN_CONTAINERS[ITEM_ID].Unit.Text, "°C");
//						if (CONTAINER == 0x09) Dash_Settings.SCREEN_CONTAINERS[ITEM_ID].Unit.X = 150;
//						if (CONTAINER == 0x0A) Dash_Settings.SCREEN_CONTAINERS[ITEM_ID].Unit.Y = 85;
//						if (CONTAINER == 0x0B) Dash_Settings.SCREEN_CONTAINERS[ITEM_ID].Unit.Width = 101;
//						if (CONTAINER == 0x0C) Dash_Settings.SCREEN_CONTAINERS[ITEM_ID].Unit.Height = 30;
//						if (CONTAINER == 0x0D) Dash_Settings.SCREEN_CONTAINERS[ITEM_ID].Unit.Alignment = ALIGN_RIGHT;
//						if (CONTAINER == 0x0E) Dash_Settings.SCREEN_CONTAINERS[ITEM_ID].Unit.Text_Color = (COLOR_RGB ) { 255, 255, 255 };
//						if (CONTAINER == 0x0F) ;//UNUSED
//					}
//					//VALUE
//					else if(CONTAINER >= 0x10 && CONTAINER <= 0x17)
//					{
//						if (CONTAINER == 0x10) strcpy(Dash_Settings.SCREEN_CONTAINERS[ITEM_ID].Value.Text, "0");
//						if (CONTAINER == 0x11) Dash_Settings.SCREEN_CONTAINERS[ITEM_ID].Value.X = 12;
//						if (CONTAINER == 0x12) Dash_Settings.SCREEN_CONTAINERS[ITEM_ID].Value.Y = -5;
//						if (CONTAINER == 0x13) Dash_Settings.SCREEN_CONTAINERS[ITEM_ID].Value.Width = 44;
//						if (CONTAINER == 0x14) Dash_Settings.SCREEN_CONTAINERS[ITEM_ID].Value.Height = 96;
//						if (CONTAINER == 0x15) Dash_Settings.SCREEN_CONTAINERS[ITEM_ID].Value.Alignment = ALIGN_LEFT;
//						if (CONTAINER == 0x16) Dash_Settings.SCREEN_CONTAINERS[ITEM_ID].Value.Text_Color = (COLOR_RGB ) { 255, 255, 255 };
//						if (CONTAINER == 0x17) ;//UNUSED
//					}
//					//DATA
//					else if(CONTAINER >= 0x18 && CONTAINER <= 0x1F)
//					{
//						if (CONTAINER == 0x18) Dash_Settings.SCREEN_CONTAINERS[ITEM_ID].Data.Channel = CH_ECT;
//						if (CONTAINER == 0x19) Dash_Settings.SCREEN_CONTAINERS[ITEM_ID].Data.Adder = 0;
//						if (CONTAINER == 0x1A) Dash_Settings.SCREEN_CONTAINERS[ITEM_ID].Data.Decimal = 0;
//						if (CONTAINER == 0x1B) Dash_Settings.SCREEN_CONTAINERS[ITEM_ID].Data.Divider = 10;
//						if (CONTAINER == 0x1C) Dash_Settings.SCREEN_CONTAINERS[ITEM_ID].Data.Default = 0;
//						if (CONTAINER == 0x1D) ;//UNUSED
//						if (CONTAINER == 0x1E) ;//UNUSED
//						if (CONTAINER == 0x1F) ;//UNUSED
//					}
//				break;
//			}
//
//			USB_RX_Ready = 0;
//			USBD_CUSTOM_HID_ReceivePacket(&hUsbDeviceFS);
//		}
		osDelay(100);
	}
	/* USER CODE END Start_HID_RECIEVE_Task */
}

void HAL_TIM_PeriodElapsedCallback(TIM_HandleTypeDef *htim) {
	if (htim->Instance == TIM6) {
		HAL_IncTick();
	}
}

void Error_Handler(void) {
	__disable_irq();
	while (1) {
	}
}
